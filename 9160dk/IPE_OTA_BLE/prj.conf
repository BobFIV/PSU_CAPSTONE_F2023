## CMakeLists.txt
```
#
# Copyright (c) 2018 Nordic Semiconductor ASA
# Copyright (c) 2018 Nordic Semiconductor
#
# SPDX-License-Identifier: LicenseRef-Nordic-5-Clause
#

cmake_minimum_required(VERSION 3.20.0)



find_package(Zephyr REQUIRED HINTS $ENV{ZEPHYR_BASE})
project(lte-ble-gateway)

# NORDIC SDK APP START
target_sources(app PRIVATE src/mqtt_connection.c)
target_sources(app PRIVATE src/main.c)
target_sources(app PRIVATE src/ble.c)
target_sources(app PRIVATE src/aggregator.c)
target_sources(app PRIVATE src/cJSON.c)
target_sources(app PRIVATE src/update.c)
target_sources(app PRIVATE src/oneM2Mmessages.c)
# NORDIC SDK APP END

zephyr_include_directories(src)
include_directories(src/orientation_detector)
```

## Kconfig
```
#
# Copyright (c) 2018 Nordic Semiconductor ASA
#
# SPDX-License-Identifier: LicenseRef-Nordic-5-Clause
#

menu "LTE BLE gateway sample"

config MQTT_PUB_TOPIC
	string "MQTT publish topic"
	default "/ESP32/Update"

config MQTT_SUB_TOPIC
	string "MQTT subscribe topic"
	default "/ESP32/Update"

config MQTT_CLIENT_ID
	string "MQTT Client ID"
	help
	  Use a custom Client ID string. If not set, the client ID will be
	  generated based on IMEI number (for nRF9160 based targets) or
	  randomly (for other platforms).
	default ""

config MQTT_BROKER_HOSTNAME
	string "MQTT broker hostname"
	default "test.mosquitto.org"

config MQTT_BROKER_PORT
	int "MQTT broker port"
	default 1883

config MQTT_MESSAGE_BUFFER_SIZE
	int "MQTT message buffer size"
	default 128

config MQTT_PAYLOAD_BUFFER_SIZE
	int "MQTT payload buffer size"
	default 128

config BUTTON_EVENT_PUBLISH_MSG
	string "The message to publish on a button event"
	default "Hi from the nRF9160 SiP"

config TURN_LED_ON_CMD
	string "Command to turn on LED"
	default "LED1ON"

config TURN_LED_OFF_CMD
	string "Command to turn off LED"
	default "LED1OFF"

config MQTT_RECONNECT_DELAY_S
	int "Seconds to delay before attempting to reconnect to the broker."
	default 60

endmenu

module=LTE_BLE_GW
module-dep=LOG
module-str= LTE BLE gateway sample
source "${ZEPHYR_BASE}/subsys/logging/Kconfig.template.log_config"

menu "Zephyr Kernel"
source "Kconfig.zephyr"
endmenu
```

## prj.conf
```kconfig
#
# Copyright (c) 2020 Nordic Semiconductor ASA
# Copyright (c) 2019 Nordic Semiconductor ASA
#
# SPDX-License-Identifier: LicenseRef-Nordic-5-Clause
#

# General config
CONFIG_NEWLIB_LIBC=y
CONFIG_NEWLIB_LIBC_FLOAT_PRINTF=y
CONFIG_ASSERT=y
CONFIG_REBOOT=y

# Logging
CONFIG_LOG=y
CONFIG_LTE_BLE_GW_LOG_LEVEL_INF=y
# CONFIG_BT_DEBUG_LOG=y

# Button and LED support
CONFIG_DK_LIBRARY=y

# Networking
CONFIG_NETWORKING=y
CONFIG_NET_NATIVE=n
CONFIG_NET_SOCKETS_OFFLOAD=y
CONFIG_NET_SOCKETS=y
CONFIG_NET_SOCKETS_POSIX_NAMES=y

# Memory
CONFIG_MAIN_STACK_SIZE=8192
CONFIG_HEAP_MEM_POOL_SIZE=32768     
CONFIG_SYSTEM_WORKQUEUE_STACK_SIZE=16384



# Modem library
CONFIG_NRF_MODEM_LIB=y
CONFIG_NRF_MODEM_LIB_SYS_INIT=n
CONFIG_NRF_MODEM_LIB_ON_FAULT_APPLICATION_SPECIFIC=y
CONFIG_NRF_MODEM_LIB_TRACE=n

# LTE link control
CONFIG_LTE_LINK_CONTROL=y
CONFIG_LTE_NETWORK_MODE_LTE_M_GPS=y
CONFIG_LTE_AUTO_INIT_AND_CONNECT=n

# AT host
CONFIG_AT_HOST_LIBRARY=y

# Modem info
CONFIG_MODEM_INFO=y
CONFIG_MODEM_INFO_ADD_NETWORK=y


# Console
CONFIG_CONSOLE_SUBSYS=y
CONFIG_CONSOLE_GETCHAR=y

# Enable the BLE stack with GATT Client configuration
CONFIG_BT=y
CONFIG_BT_CENTRAL=y
CONFIG_BT_SMP=y
CONFIG_BT_SETTINGS=y
CONFIG_BT_GATT_CLIENT=y
CONFIG_BT_MAX_CONN=2
CONFIG_BT_MAX_PAIRED=2
CONFIG_BT_CONN_CTX=y


# Enable the BLE modules from NCS
CONFIG_BT_NUS_CLIENT=y
CONFIG_BT_SCAN=y
CONFIG_BT_SCAN_FILTER_ENABLE=y
CONFIG_BT_SCAN_UUID_CNT=1
CONFIG_BT_SCAN_NAME_CNT=1
CONFIG_BT_GATT_DM=y

# Bluetooth Configurations
CONFIG_BT_ATT_PREPARE_COUNT=2
CONFIG_BT_CONN_TX_MAX=10
CONFIG_BT_L2CAP_TX_BUF_COUNT=10
CONFIG_BT_L2CAP_TX_MTU=247
CONFIG_BT_BUF_ACL_RX_SIZE=251
#CONFIG_BT_BUF_ACL_TX_SIZE=251
CONFIG_BT_L2CAP_DYNAMIC_CHANNEL=y
CONFIG_BT_BUF_ACL_RX_COUNT=4
CONFIG_BT_BUF_ACL_TX_COUNT=4



#Enable MCU boot
CONFIG_BOOTLOADER_MCUBOOT=y
CONFIG_STREAM_FLASH=y
CONFIG_IMG_MANAGER=y
CONFIG_IMG_BLOCK_BUF_SIZE=512

#Enable Base64 Encoding
CONFIG_BASE64=y



# Enable bonding

CONFIG_FLASH=y
CONFIG_FLASH_PAGE_LAYOUT=y
CONFIG_FLASH_MAP=y
CONFIG_NVS=y
CONFIG_SETTINGS=y

CONFIG_UART_INTERRUPT_DRIVEN=y

# MQTT
CONFIG_MQTT_LIB=y
CONFIG_MQTT_CLEAN_SESSION=y
CONFIG_MQTT_PUB_TOPIC="/oneM2M/req/NRFParent:NRF9160/capstone-iot/json"
CONFIG_MQTT_SUB_TOPIC="/oneM2M/resp/NRFParent:NRF9160/capstone-iot/json"
#CONFIG_MQTT_SUB_TOPIC="/ESP32/Update"
CONFIG_BUTTON_EVENT_PUBLISH_MSG="{\"op\":2,\"to\":\"cse-in/NRFParent\",\"fr\":\"CNRFParent\",\"rqi\":\"123\",\"rvi\":\"3\",\"fu\":6,\"ty\":4,\"rcn\":4}"
CONFIG_MQTT_BROKER_HOSTNAME="52.14.47.13"
CONFIG_MQTT_BROKER_PORT=1883
```

## boards/nrf9160dk_nrf9160_ns.conf
```kconfig
CONFIG_NRF_SW_LPUART=y
CONFIG_NRF_SW_LPUART_INT_DRIVEN=y

CONFIG_UART_2_ASYNC=y
CONFIG_UART_2_INTERRUPT_DRIVEN=n
CONFIG_UART_2_NRF_HW_ASYNC=y
CONFIG_UART_2_NRF_HW_ASYNC_TIMER=2


CONFIG_SPI=y
CONFIG_SPI_NOR=y
```

## src/main.c
```c
/*
*	Revision: Release Version 1.0
*	Last Edited: 11/15/2023
*	Author: Yuh Kurose, based on many different samples and examples from Nordic Semiconductor ASA.
*	Sponsor: Exacta Global Smart Solutions
*	See the README for more information.
 */
/*
	main.c is used for initialization of the device.
*/
#include <zephyr/kernel.h>
#include <stdio.h>
#include <zephyr/net/socket.h>


#include <string.h>
#include <zephyr/console/console.h>
#include <dk_buttons_and_leds.h>
#include <modem/lte_lc.h>
#include <zephyr/sys/reboot.h>
#include <modem/nrf_modem_lib.h>
#include <zephyr/logging/log.h>
#include <zephyr/net/mqtt.h>
#include <stdbool.h>


#include "mqtt_connection.h"
#include "ble.h"
#include "aggregator.h"
#include "update.h"
#include "oneM2Mmessages.h"
#include "main.h"




#define FAST_BLINK_INTERVAL 250  // 250 ms.
#define SLOW_BLINK_INTERVAL 500  
#define VERY_SLOW_BLINK_INTERVAL 1000  

static K_SEM_DEFINE(lte_connected, 0, 1);
/* The mqtt client struct */
struct mqtt_client client;
/* File descriptor */
struct pollfd fds;

uint32_t led_condition = 0; //Current LED condition.

LOG_MODULE_REGISTER(lte_ble_gw, CONFIG_LTE_BLE_GW_LOG_LEVEL);

/* Interval in milliseconds between each time status LEDs are updated. */
#define LEDS_UPDATE_INTERVAL K_MSEC(500)

/* Interval in microseconds between each time LEDs are updated when indicating
 * that an error has occurred.
 */
#define LEDS_ERROR_UPDATE_INTERVAL 250000

#define BUTTON_1 BIT(0)
#define BUTTON_2 BIT(1)
#define SWITCH_1 BIT(2)
#define SWITCH_2 BIT(3)

#define LED_ON(x)			(x)
#define LED_BLINK(x)		((x) << 8)
#define LED_GET_ON(x)		((x) & 0xFF)
#define LED_GET_BLINK(x)	(((x) >> 8) & 0xFF)
#define LEDS_RAPID_BLINK_INTERVAL K_MSEC(100) // 100 milliseconds


/* Interval in milliseconds after the device will retry cloud connection
 * if the event NRF_CLOUD_EVT_TRANSPORT_CONNECTED is not received.
 */
#define RETRY_CONNECT_WAIT K_MSEC(90000)

/* Structures for work */
struct k_work_delayable leds_update_work;
struct k_work_delayable periodic_transmit_work;
struct k_work_delayable periodic_publish_work;


enum error_type {
	ERROR_NRF_CLOUD,
	ERROR_MODEM_RECOVERABLE,
};

/* Forward declaration of functions. */
static void work_init(void);

static void lte_handler(const struct lte_lc_evt *const evt)
{
     switch (evt->type) {
     case LTE_LC_EVT_NW_REG_STATUS:
        if ((evt->nw_reg_status != LTE_LC_NW_REG_REGISTERED_HOME) &&
            (evt->nw_reg_status != LTE_LC_NW_REG_REGISTERED_ROAMING)) {
            break;
        }
		LOG_INF("Network registration status: %s",
				evt->nw_reg_status == LTE_LC_NW_REG_REGISTERED_HOME ?
				"Connected - home network" : "Connected - roaming");
		k_sem_give(&lte_connected);
        break;
	case LTE_LC_EVT_RRC_UPDATE:
		LOG_INF("RRC mode: %s", evt->rrc_mode == LTE_LC_RRC_MODE_CONNECTED ?
				"Connected" : "Idle");
		break;
     default:
             break;
     }
}


/**@brief nRF Cloud error handler. */
void error_handler(enum error_type err_type, int err)
{
	if (err_type == ERROR_NRF_CLOUD) {
		int err;

		/* Turn off and shutdown modem */
		k_sched_lock();
		err = lte_lc_power_off();
		__ASSERT(err == 0, "lte_lc_power_off failed: %d", err);
		nrf_modem_lib_shutdown();
	}

#if !defined(CONFIG_DEBUG)
	sys_reboot(SYS_REBOOT_COLD);
#else
	uint8_t led_pattern;

	switch (err_type) {
	case ERROR_NRF_CLOUD:
		/* Blinking all LEDs ON/OFF in pairs (1 and 4, 2 and 3)
		 * f there is an application error.
		 */
		led_pattern = DK_LED1_MSK | DK_LED4_MSK;
		LOG_ERR("Error of type ERROR_NRF_CLOUD: %d", err);
		break;
	case ERROR_MODEM_RECOVERABLE:
		/* Blinking all LEDs ON/OFF in pairs (1 and 3, 2 and 4)
		 * if there is a recoverable error.
		 */
		led_pattern = DK_LED1_MSK | DK_LED3_MSK;
		LOG_ERR("Error of type ERROR_MODEM_RECOVERABLE: %d", err);
		break;
	default:
		/* Blinking all LEDs ON/OFF in pairs (1 and 2, 3 and 4)
		 * undefined error.
		 */
		led_pattern = DK_LED1_MSK | DK_LED2_MSK;
		break;
	}

	while (true) {
		dk_set_leds(led_pattern & 0x0f);
		k_busy_wait(LEDS_ERROR_UPDATE_INTERVAL);
		dk_set_leds(~led_pattern & 0x0f);
		k_busy_wait(LEDS_ERROR_UPDATE_INTERVAL);
	}
#endif /* CONFIG_DEBUG */
}

/**@brief Modem fault handler. */
void nrf_modem_fault_handler(struct nrf_modem_fault_info *fault_info)
{
	error_handler(ERROR_MODEM_RECOVERABLE, (int)fault_info->reason);
}
//static uint32_t last_update = 0;

/**@brief Update LEDs state. */
static void leds_update(struct k_work *work) {
    static bool fast_blink_on = false, slow_blink_on = false, very_slow_blink_on = false;
    static uint32_t last_fast_blink = 0, last_slow_blink = 0, last_very_slow_blink = 0;
    uint8_t led_blink_mask = 0, led_on_mask = 0;
    uint32_t now = k_uptime_get_32();

    // Fast Blink Toggle
    if (now - last_fast_blink >= FAST_BLINK_INTERVAL) {
        fast_blink_on = !fast_blink_on;
        last_fast_blink = now;
    }

    // Slow Blink Toggle
    if (now - last_slow_blink >= SLOW_BLINK_INTERVAL) {
        slow_blink_on = !slow_blink_on;
        last_slow_blink = now;
    }

    // Very Slow Blink Toggle
    if (now - last_very_slow_blink >= VERY_SLOW_BLINK_INTERVAL) {
        very_slow_blink_on = !very_slow_blink_on;
        last_very_slow_blink = now;
    }

    // Set LED masks based on conditions
    if ((led_condition & CONDITION_ESP32_CONNECTING) && fast_blink_on) {
        led_blink_mask |= DK_LED1_MSK;
    } else if ((led_condition & CONDITION_ESP32_SCANNING) && slow_blink_on) {
        led_blink_mask |= DK_LED1_MSK;
    } else if ((led_condition & CONDITION_ESP32_UPDATING) && very_slow_blink_on) {
        led_blink_mask |= DK_LED1_MSK;
    } else if (led_condition & CONDITION_ESP32_CONNECTED) {
        led_on_mask |= DK_LED1_MSK;
    }

	if ((led_condition & CONDITION_RPI_CONNECTING) && fast_blink_on) {
		led_blink_mask |= DK_LED2_MSK;
	} else if ((led_condition & CONDITION_RPI_SCANNING) && slow_blink_on) {
		led_blink_mask |= DK_LED2_MSK;
	} else if ((led_condition & CONDITION_RPI_UPDATING) && very_slow_blink_on) {
		led_blink_mask |= DK_LED2_MSK;
	} else if (led_condition & CONDITION_RPI_CONNECTED) {
		led_on_mask |= DK_LED2_MSK;
	}

	// LTE and MQTT Conditions
	if ((led_condition & CONDITION_LTE_CONNECTING) && slow_blink_on) {
		led_blink_mask |= DK_LED3_MSK;
	} else if ((led_condition & CONDITION_MQTT_CONNECTING) && fast_blink_on) {
		led_blink_mask |= DK_LED3_MSK;
	} else if (led_condition & CONDITION_MQTT_LTE_CONNECTED) {
		led_on_mask |= DK_LED3_MSK;
	}

   // Update LEDs
    dk_set_leds(led_blink_mask | led_on_mask);

    // Reschedule work
    k_work_schedule(&leds_update_work, LEDS_UPDATE_INTERVAL);
}


/**@brief Callback for button events from the DK buttons and LEDs library. */
static void button_handler(uint32_t buttons, uint32_t has_changed)
{
	switch (has_changed) {
	case DK_BTN1_MSK:
		/* STEP 7.2 - When button 1 is pressed, call data_publish() to publish a message */
		if (buttons & DK_BTN1_MSK){
			int err = data_publish(&client, MQTT_QOS_1_AT_LEAST_ONCE,
				   CONFIG_BUTTON_EVENT_PUBLISH_MSG, sizeof(CONFIG_BUTTON_EVENT_PUBLISH_MSG), "/oneM2M/req/NRFParent:NRF9160/capstone-iot/json"); //if this doesn't work, add -1 back to sizeof. 
			if (err) {
				LOG_INF("Failed to send message, %d", err);
				return;
			}
		}
		break;
	}
}

/**@brief Initializes and submits delayed work. */
static void work_init(void)
{
	k_work_init_delayable(&leds_update_work, leds_update);
	k_work_schedule(&leds_update_work, LEDS_UPDATE_INTERVAL);
	k_work_init_delayable(&periodic_transmit_work, transmit_aggregated_data);
	k_work_schedule(&periodic_transmit_work, K_MSEC(1000));
	k_work_init_delayable(&periodic_publish_work, publish_aggregated_data);
	k_work_schedule(&periodic_publish_work, K_MSEC(1000));
}

/**@brief Configures modem to provide LTE link. Blocks until link is
 * successfully established.
 */

static int modem_configure(void)
{
	int err;
	led_condition |= CONDITION_LTE_CONNECTING; //Set LED condition to LTE connecting.
	LOG_INF("Initializing modem library");

	err = nrf_modem_lib_init();
	if (err) {
		LOG_ERR("Failed to initialize the modem library, error: %d", err);
		return err;
	}

	LOG_INF("Connecting to LTE network");

	err = lte_lc_init_and_connect_async(lte_handler);
	if (err) {
		LOG_INF("Modem could not be configured, error: %d", err);
		return err;
	}

	k_sem_take(&lte_connected, K_FOREVER);
	LOG_INF("Connected to LTE network");
	led_condition &= ~CONDITION_LTE_CONNECTING; 
	led_condition |= CONDITION_MQTT_CONNECTING;	//LTE is complete. Next step is MQTT.

	return 0;
}

int main(void)
{
	
	int err;
	uint32_t connect_attempt = 0;
	LOG_INF("Welcome to PSU CAPSTONE FALL 2023");

	if (dk_leds_init() != 0) {
		LOG_ERR("Failed to initialize the LED library");
	}
	err = modem_configure();
	if (err) {
		LOG_ERR("Failed to configure the modem");
		return 0;
	}

	if (dk_buttons_init(button_handler) != 0) {
		LOG_ERR("Failed to initialize the buttons library");
	}

	err = client_init(&client);
	if (err) {
		LOG_ERR("Failed to initialize MQTT client: %d", err);
		return 0;
	}
	//updating the flex container for 9160.
	updateFlexContainerForConnectedDevice("9160", true);
	
	work_init();		//Initalize work: Uplink Aggregator publish, Downlink transmit and LED functions.
	err = ble_init();		    //Initializes bluetooth (ble.c)
	if (err) {
		LOG_ERR("Failed to initialize BLE: %d", err);
		return 0;
	}
	err = OTAInit();		//Initializes OTA update (update.c)
	if (err) {
		LOG_ERR("Failed to initialize OTA: %d", err);
		return 0;
	}
do_connect:
	if (connect_attempt++ > 0) {
		LOG_INF("Reconnecting in %d seconds...",
			CONFIG_MQTT_RECONNECT_DELAY_S);
		k_sleep(K_SECONDS(CONFIG_MQTT_RECONNECT_DELAY_S));
	}
	err = mqtt_connect(&client);
	if (err) {
		LOG_ERR("Error in mqtt_connect: %d", err);
		goto do_connect;
	}

	err = fds_init(&client,&fds);
	if (err) {
		LOG_ERR("Error in fds_init: %d", err);
		return 0;
	}

	while (1) {
		err = poll(&fds, 1, mqtt_keepalive_time_left(&client));
		if (err < 0) {
			LOG_ERR("Error in poll(): %d", errno);
			break;
		}

		err = mqtt_live(&client);
		if ((err != 0) && (err != -EAGAIN)) {
			LOG_ERR("Error in mqtt_live: %d", err);
			break;
		}

		if ((fds.revents & POLLIN) == POLLIN) {
			err = mqtt_input(&client);
			if (err != 0) {
				LOG_ERR("Error in mqtt_input: %d", err);
				break;
			}
		}

		if ((fds.revents & POLLERR) == POLLERR) {
			LOG_ERR("POLLERR");
			break;
		}

		if ((fds.revents & POLLNVAL) == POLLNVAL) {
			LOG_ERR("POLLNVAL");
			break;
		}
	}

	LOG_INF("Disconnecting MQTT client");

	err = mqtt_disconnect(&client);
	if (err) {
		LOG_ERR("Could not disconnect MQTT client: %d", err);
	}
	goto do_connect;
	LOG_ERR("How'd we get here?");
	/* This is never reached */
	return 0;
}
```

## src/aggregator.c
```c
/*
 * Copyright (c) 2018 Nordic Semiconductor ASA
 *
 * SPDX-License-Identifier: LicenseRef-Nordic-5-Clause
 */

#include <zephyr/kernel.h>
#include <zephyr/kernel.h>
#include <stdio.h>
#include <zephyr/types.h>
#include <string.h>
#include <zephyr/net/mqtt.h>
#include <zephyr/irq.h>
#include <zephyr/logging/log.h>

#include "aggregator.h"
#include "mqtt_connection.h"
#include "ble.h"
#include "main.h"
#include "cJSON.h"

LOG_MODULE_DECLARE(lte_ble_gw);

#define SERIALIZED_DATA_MAX_SIZE 300 // Some number. Probably wrong. To-Do: Update.
K_FIFO_DEFINE(uplink_aggregator_fifo);
K_FIFO_DEFINE(downlink_aggregator_fifo);

static uint32_t uplink_entry_count;

static uint32_t downlink_entry_count;

struct uplink_fifo_entry {
	void *fifo_reserved;
	uint8_t data[sizeof(struct uplink_data_packet)];
};

struct downlink_fifo_entry {
	void *fifo_reserved;
	uint8_t data[sizeof(struct downlink_data_packet)];
};

int uplink_aggregator_put(struct uplink_data_packet in_data)
{
	struct uplink_fifo_entry *fifo_data = NULL;
	uint32_t  lock = irq_lock();
	int    err  = 0;

	if (uplink_entry_count == FIFO_MAX_ELEMENT_COUNT) {
		fifo_data = k_fifo_get(&uplink_aggregator_fifo, K_NO_WAIT);

		__ASSERT(fifo_data != NULL, "fifo_data should not be NULL");

		uplink_entry_count--;
	}

	if (fifo_data == NULL) {
		fifo_data = k_malloc(sizeof(struct uplink_fifo_entry));
	}

	if (fifo_data == NULL) {
		err = -ENOMEM;
		goto exit;
	}

	memcpy(fifo_data->data, &in_data, sizeof(in_data));

	k_fifo_put(&uplink_aggregator_fifo, fifo_data);
	uplink_entry_count++;

exit:
	irq_unlock(lock);
	return err;
}

int uplink_aggregator_get(struct uplink_data_packet *out_data)
{
	void  *fifo_data;
	int   err = 0;

	if (out_data == NULL) {
		return -EINVAL;
	}

	uint32_t lock = 0;
	lock = irq_lock();

	fifo_data = k_fifo_get(&uplink_aggregator_fifo, K_NO_WAIT);
	if (fifo_data == NULL) {
		err = -ENODATA;
		goto exit;
	}

	memcpy(out_data, ((struct uplink_fifo_entry *)fifo_data)->data,
	       sizeof(struct uplink_data_packet));

	k_free(fifo_data);
	uplink_entry_count--;

exit:
	irq_unlock(lock);
	return err;
}




int downlink_aggregator_get(struct downlink_data_packet *out_data)
{
	//LOG_INF ("downlink_aggregator_get called"); //Super spammy.
	void  *fifo_data;
	int   err = 0;
	
	if (out_data == NULL) {
		//LOG_INF ("OutData is NULL");
		return -EINVAL;
	}


	fifo_data = k_fifo_get(&downlink_aggregator_fifo, K_NO_WAIT);
	if (fifo_data == NULL) {
		err = -ENODATA;
		//LOG_INF ("FIFO is Empty"); //Super spammy.
		goto exit;
	}


	uint32_t lock = irq_lock();


	memcpy(out_data, ((struct downlink_fifo_entry *)fifo_data)->data,
	       sizeof(struct downlink_data_packet));
	LOG_INF ("downlink_aggregator_get: %s", out_data->data);
	k_free(fifo_data);
	downlink_entry_count--;

exit:
	irq_unlock(lock);
	return err;
}

int downlink_aggregator_put(struct downlink_data_packet in_data)
{
	struct downlink_fifo_entry *fifo_data = NULL;
	uint32_t  lock = irq_lock();
	int	err  = 0;
	LOG_INF ("downlink_aggregator_put called");
	if (downlink_entry_count == FIFO_MAX_ELEMENT_COUNT) {
		fifo_data = k_fifo_get(&downlink_aggregator_fifo, K_NO_WAIT);

		__ASSERT(fifo_data != NULL, "fifo_data should not be NULL");

		downlink_entry_count--;
	}

	if (fifo_data == NULL) {
		fifo_data = k_malloc(sizeof(struct downlink_fifo_entry));
	}

	if (fifo_data == NULL) {
		err = -ENOMEM;
		goto exit;
	}
	
	memcpy(fifo_data->data, &in_data, sizeof(struct downlink_data_packet));
	LOG_INF("downlink_aggregator_put: %s", in_data.data);
	k_fifo_put(&downlink_aggregator_fifo, fifo_data);
	downlink_entry_count++;

exit:
	irq_unlock(lock);
	return err;
}

void aggregator_clear(void)
{
	void *fifo_data;
	uint32_t lock = 0;
	lock = irq_lock();

	while (1) {
		fifo_data = k_fifo_get(&uplink_aggregator_fifo, K_NO_WAIT);

		if (fifo_data == NULL) {
			break;
		}

		k_free(fifo_data);
	};

	uplink_entry_count = 0;

	while (1) {
		fifo_data = k_fifo_get(&downlink_aggregator_fifo, K_NO_WAIT);

		if (fifo_data == NULL) {
			break;
		}

		k_free(fifo_data);
	};
	downlink_entry_count = 0;
	irq_unlock(lock);
}



char *serialize_uplink_packet_to_json(const struct uplink_data_packet *packet) {
    cJSON *root = cJSON_CreateObject();
    if (root == NULL) {
        LOG_ERR("Failed to create JSON object");
        return NULL;
    }

    switch (packet->type) {
        case uplink_FIRMWARE_ERROR:
            
            cJSON_AddStringToObject(root, "Firmware Error", (char *)packet->data);
            break;

        case uplink_FIRMWARE_ACK:
            
            cJSON_AddStringToObject(root, "Firmware ACK", (char *)packet->data);
            break;

        case uplink_FIRMWARE_VERSION:
            // TODO: Format the firmware version into oneM2M format
            cJSON_AddStringToObject(root, "Firmware Version", (char *)packet->data);
            break;

        case uplink_TRAIN_LOCATION:
            cJSON_AddStringToObject(root, "type", "Train Location");
            cJSON_AddStringToObject(root, "location", (char *)packet->data);
            break;

        default:
            LOG_ERR("Unsupported packet type");
            cJSON_Delete(root);
            return NULL;
    }

    char *jsonString = cJSON_PrintUnformatted(root);
    cJSON_Delete(root);

    return jsonString; // Caller must free this memory with cJSON_free()
}


const char* setTopic(enum uplink_data_packet_type packetType, enum ble_source source) {
    switch (packetType) {
        case uplink_FIRMWARE_ERROR:
        case uplink_FIRMWARE_ACK:
            if (source == SOURCE_ESP32) {
                return "/ESP32/Update";
            } else if (source == SOURCE_RaspberryPi) {
                return "/RaspberryPi/Update";
            }
            break;

        case uplink_FIRMWARE_VERSION:
            return "/oneM2M/resp/capstone-iot/NRFParent/json";  

        case uplink_TRAIN_LOCATION:
            // Location data from Raspberry Pi to Django
            return "/RaspberryPi/Data";


        default:
            LOG_ERR("Unknown data type");
            break;
    }

    // Default topic or error handling
    return "/Unknown/Topic";
}



void publish_aggregated_data(struct k_work *work) {
    ARG_UNUSED(work);
    struct k_work_delayable *dwork = CONTAINER_OF(work, struct k_work_delayable, work);

    struct uplink_data_packet data_packet;

    while (uplink_aggregator_get(&data_packet) == 0) {
        // Serialize data packet to JSON
        char *json_payload = serialize_uplink_packet_to_json(&data_packet);
        if (json_payload == NULL) {
            continue;
        }

        // Determine the appropriate topic
        const char *topic = setTopic(data_packet.type, data_packet.source);

        if (topic == NULL) {
            LOG_ERR("Unknown data source");
            cJSON_free(json_payload);
            continue;
        }

        // Publish the JSON payload
        if (data_publish(&client, MQTT_QOS_1_AT_LEAST_ONCE, json_payload, strlen(json_payload), topic) != 0) {
            LOG_ERR("Failed to publish data to topic %s", topic);
        }

        cJSON_free(json_payload);
    }

    k_work_reschedule(dwork, K_MSEC(100));
}

void transmit_aggregated_data(struct k_work *work) {
    struct k_work_delayable *dwork = CONTAINER_OF(work, struct k_work_delayable, work);

    struct downlink_data_packet packet;
    while (downlink_aggregator_get(&packet) == 0) {
        
        if (packet.length == 0) {
            LOG_ERR("No data to transmit or data length is zero");
            continue;
        }

        if (packet.destination == DESTINATION_ESP32){
            ble_transmit("ESP32", packet.data, packet.length);
        } else if (packet.destination == DESTINATION_RaspberryPi) {
            ble_transmit("RPi", packet.data, packet.length);
        } else {
            LOG_ERR("Unknown destination");
            continue;
        }
    }

    k_work_reschedule(dwork, K_MSEC(100));
}
```

## src/aggregator.h
```c
/*
 * Copyright (c) 2018 Nordic Semiconductor ASA
 *
 * SPDX-License-Identifier: LicenseRef-Nordic-5-Clause
 */

#ifndef _AGGREGATOR_H_
#define _AGGREGATOR_H_
#include <stdint.h>


/*
 * Simple aggregator module which can have sensordata added and retrieved in a
 * FIFO fashion. The queue allows TLD formated data to be aggregated from
 * sensors in a FIFO fashion. When some event in the future causes data
 * transfer to start, the most recent X datapoints (determined by ENTRY_MAX_SIZE
 * and HEAP_MEM_POOL_SIZE) can be transferred.
 *
 * Note: The module is single instance to allow simple global access to the
 * data.
 * 
 * This is edited from the original sample program.
 */


#define ENTRY_MAX_SIZE (247)				//This is probably wrong. Will have to change later.
#define FIFO_MAX_ELEMENT_COUNT 12

enum uplink_data_packet_type {						//Data types for going up are text and image.
	uplink_FIRMWARE_ERROR,
    uplink_FIRMWARE_ACK,
    uplink_FIRMWARE_VERSION,
    uplink_TRAIN_LOCATION,
	uplink_oneM2M_JSON,
};
enum ble_source {
	SOURCE_ESP32,
	SOURCE_RaspberryPi,
};

struct uplink_data_packet {						//This is the data structure that will be used to store data going upwards to MQTT.
	uint8_t length;
	enum uplink_data_packet_type type;
	enum ble_source source;
	uint8_t data[ENTRY_MAX_SIZE];
};

enum downlink_data_packet_type {					//Data types for going down are firmware update and image.
	downlink_TEXT,
	downlink_IMAGE,
	FIRMWARE_UPDATE,
};
enum ble_destination {					//Destination for data going down is either ESP32 or Raspberry Pi.
	DESTINATION_ESP32,					
	DESTINATION_RaspberryPi,
	DESTINATION_UNKNOWN,
};



struct downlink_data_packet {				//This is the data structure that is used to store data going downwards to BLE.
	uint8_t length;
	enum downlink_data_packet_type type;
	enum ble_destination destination;
	int chunk_id;
	char data[ENTRY_MAX_SIZE];			//May be a Base 64 encoded firmware, Image, or Text
	uint32_t checksum;
};



int aggregator_init(void);

int uplink_aggregator_put(struct uplink_data_packet data);

int uplink_aggregator_get(struct uplink_data_packet *data);

int downlink_aggregator_put(struct downlink_data_packet data);

int downlink_aggregator_get(struct downlink_data_packet *data);

void aggregator_clear(void);

int aggregator_element_count_get(void);

void publish_aggregated_data(struct k_work *work);

void transmit_aggregated_data(struct k_work *work);

#endif /* _AGGREGATOR_H_ */
```

## src/main.h
```c
#ifndef MAIN_H
#define MAIN_H
#include <stdint.h>


//why the heck do I need to do this...
extern struct mqtt_client client;
extern struct k_work_delayable periodic_publish_work;
extern struct k_work_delayable periodic_transmit_work;

extern uint32_t led_condition;
#define CONDITION_ESP32_CONNECTING   (1 << 0)
#define CONDITION_ESP32_SCANNING     (1 << 1)
#define CONDITION_ESP32_UPDATING     (1 << 2)
#define CONDITION_ESP32_CONNECTED    (1 << 3)
#define CONDITION_RPI_CONNECTING     (1 << 4)
#define CONDITION_RPI_SCANNING       (1 << 5)
#define CONDITION_RPI_UPDATING       (1 << 6)
#define CONDITION_RPI_CONNECTED      (1 << 7)
#define CONDITION_LTE_CONNECTING     (1 << 8)
#define CONDITION_MQTT_CONNECTING    (1 << 9)
#define CONDITION_MQTT_LTE_CONNECTED (1 << 10)
#define CONDITION_FIRMWARE_UPDATING  (1 << 11)
#define CONDITION_FIRMWARE_DONE      (1 << 12)

#endif // MAIN_H
```

## src/mqtt_ble_pipe.c
```c
#include <string.h>
#include <stdbool.h>
#include <net/nrf_cloud.h>
#include <zephyr/logging/log.h>
#include <stdio.h>


#include "aggregator.h"
#include "mqtt_connection.h"
#include "ble.h"
#include "mqtt_ble_pipe.h"
#include "main.h"
#include "cJSON.h"

LOG_MODULE_DECLARE(lte_ble_gw);


#define SERIALIZED_DATA_MAX_SIZE 300  // Some number. Probably wrong. To-Do: Update.


char *serialize_uplink_packet_to_json(const struct uplink_data_packet *packet) {
    cJSON *root = cJSON_CreateObject();
    if (root == NULL) {
        LOG_ERR("Failed to create JSON object");
        return NULL;
    }

    switch (packet->type) {
        case uplink_FIRMWARE_ERROR:
            
            cJSON_AddStringToObject(root, "Firmware Error", (char *)packet->data);
            break;

        case uplink_FIRMWARE_ACK:
            
            cJSON_AddStringToObject(root, "Firmware ACK", (char *)packet->data);
            break;

        case uplink_FIRMWARE_VERSION:
            // TODO: Format the firmware version into oneM2M format
            cJSON_AddStringToObject(root, "Firmware Version", (char *)packet->data);
            break;

        case uplink_TRAIN_LOCATION:
            cJSON_AddStringToObject(root, "type", "Train Location");
            cJSON_AddStringToObject(root, "location", (char *)packet->data);
            break;

        default:
            LOG_ERR("Unsupported packet type");
            cJSON_Delete(root);
            return NULL;
    }

    char *jsonString = cJSON_PrintUnformatted(root);
    cJSON_Delete(root);

    return jsonString; // Caller must free this memory with cJSON_free()
}

const char* setTopic(enum uplink_data_packet_type packetType, enum ble_source source) {
    switch (packetType) {
        case uplink_FIRMWARE_ERROR:
        case uplink_FIRMWARE_ACK:
            if (source == SOURCE_ESP32) {
                return "/ESP32/Update";
            } else if (source == SOURCE_RaspberryPi) {
                return "/RaspberryPi/Update";
            }
            break;

        case uplink_FIRMWARE_VERSION:
            return "/oneM2M/resp/capstone-iot/NRFParent/json";  

        case uplink_TRAIN_LOCATION:
            // Location data from Raspberry Pi to Django
            return "/RaspberryPi/Data";


        default:
            LOG_ERR("Unknown data type");
            break;
    }

    // Default topic or error handling
    return "/Unknown/Topic";
}



void publish_aggregated_data(struct k_work *work) {
    ARG_UNUSED(work);
    struct k_work_delayable *dwork = CONTAINER_OF(work, struct k_work_delayable, work);

    struct uplink_data_packet data_packet;

    while (uplink_aggregator_get(&data_packet) == 0) {
        // Serialize data packet to JSON
        char *json_payload = serialize_uplink_packet_to_json(&data_packet);
        if (json_payload == NULL) {
            continue;
        }

        // Determine the appropriate topic
        const char *topic = setTopic(data_packet.type, data_packet.source);

        if (topic == NULL) {
            LOG_ERR("Unknown data source");
            cJSON_free(json_payload);
            continue;
        }

        // Publish the JSON payload
        if (data_publish(&client, MQTT_QOS_1_AT_LEAST_ONCE, json_payload, strlen(json_payload), topic) != 0) {
            LOG_ERR("Failed to publish data to topic %s", topic);
        }

        cJSON_free(json_payload);
    }

    k_work_reschedule(dwork, K_MSEC(100));
}

char *create_json_message_for_ble(const struct downlink_data_packet *packet) {
    if (!packet) {
        return NULL;
    }

    cJSON *root = cJSON_CreateObject();
    if (!root) {
        // Handle error
        return NULL;
    }

    switch (packet->type) {
        case FIRMWARE_UPDATE:
            cJSON_AddNumberToObject(root, "I", packet->chunk_id); // Assuming chunk_id is a field in your struct
            cJSON_AddStringToObject(root, "D", packet->data);
            char checksumStr[20]; // Make sure this buffer is large enough to hold the checksum as a string
            snprintf(checksumStr, sizeof(checksumStr), "%u", packet->checksum);
            cJSON_AddStringToObject(root, "C", checksumStr);
            break;
        case downlink_TEXT:
            cJSON_AddStringToObject(root, "Message", packet->data);
            break;
        default:
            cJSON_Delete(root);
            return NULL;
    }

    char *json_string = cJSON_PrintUnformatted(root);
    cJSON_Delete(root);
    return json_string; // Remember to free this string after use
}


void transmit_aggregated_data(struct k_work *work) {
    struct k_work_delayable *dwork = CONTAINER_OF(work, struct k_work_delayable, work);

    struct downlink_data_packet packet;
    while (downlink_aggregator_get(&packet) == 0) {
        char *json_message = create_json_message_for_ble(&packet);
        
        if (json_message == NULL) {
            LOG_ERR("Failed to create JSON message");
            continue;
        }
        if (packet.destination == DESTINATION_ESP32){
            ble_transmit("ESP32", (uint8_t *)json_message, strlen(json_message));
        } else if (packet.destination == DESTINATION_RaspberryPi) {
            ble_transmit("RaspberryPi", (uint8_t *)json_message, strlen(json_message));
        } else {
            LOG_ERR("Unknown destination");
            continue;
        }

        free(json_message);
    }

    k_work_reschedule(dwork, K_MSEC(100));
}
```

## src/oneM2Mmessages.c
```c
#include <stdio.h>
#include <string.h>
#include <stdbool.h>
#include <zephyr/net/mqtt.h>
#include <zephyr/logging/log.h>

#include "oneM2Mmessages.h"
#include "mqtt_connection.h"
#include "cJSON.h"
#include "aggregator.h"
#include "main.h"

LOG_MODULE_DECLARE(lte_ble_gw);

//dmPackage creations are handled in mqtt_connection.c
//This file handles all outgoing oneM2M messages.
//Subscriptions are created here and updates to dmDevice Info are created and sent here.



int createSubscribeMessage()
{

    cJSON *root = cJSON_CreateObject();

    // Value pairs
    cJSON_AddStringToObject(root, "fr", "CNRFParent");
    cJSON_AddNumberToObject(root, "op", 1);
    cJSON_AddStringToObject(root, "rqi", "m_createSUBChild12");
    cJSON_AddNumberToObject(root, "rvi", 4);
    cJSON_AddStringToObject(root, "to", "cse-in/NRFParent");
    cJSON_AddNumberToObject(root, "ty", 23);

    // Create the 'pc' object
    cJSON *pc = cJSON_CreateObject();
    cJSON_AddItemToObject(root, "pc", pc);

    // Create the 'm2m:sub' object
    cJSON *sub = cJSON_CreateObject();
    cJSON_AddItemToObject(pc, "m2m:sub", sub);

    // Add elements to 'm2m:sub'
    cJSON_AddNumberToObject(sub, "nct", 1);
    cJSON_AddStringToObject(sub, "rn", "NotificationRpiNew");

    // Create the 'nu' array
    cJSON *nu = cJSON_CreateArray();
    cJSON_AddItemToArray(nu, cJSON_CreateString("mqtt://52.14.47.13:1883//NRFParent/json"));
    cJSON_AddItemToObject(sub, "nu", nu);

    // Create the 'enc' object
    cJSON *enc = cJSON_CreateObject();
    cJSON_AddItemToObject(sub, "enc", enc);

    // Create the 'net' array and add it to 'enc'
    cJSON *net = cJSON_CreateIntArray((int[]){1, 2, 3, 4}, 4);
    cJSON_AddItemToObject(enc, "net", net);

    data_publish(&client, MQTT_QOS_1_AT_LEAST_ONCE, (uint8_t *)root->valuestring, strlen(root->valuestring), "cse-in/NRFParent/json");
    cJSON_Delete(root);
    return 0;
}


/*
UpdateFlexContainerForConnectedDevice
This function creates a JSON structure to update the dmDIO (dmDeviceInfo) attribute of a specific device's flex container.
When connected is true, the device is connected and the state is set to 3 (active).
When connected is false, the device is disconnected and the state is set to 1 (inactive).
*/

int updateFlexContainerForConnectedDevice(const char *deviceType, bool connected)  //Called when a device is connected.
{
    // Create the root node
    cJSON *root = cJSON_CreateObject();

    char to[50];    // Set the flex container to update.

    if (strcmp(deviceType, "9160") == 0) {
        snprintf(to, sizeof(to), "cse-in/NRFParent/9160Container");
    } else if (strcmp(deviceType, "ESP32") == 0) {
        snprintf(to, sizeof(to), "cse-in/NRFParent/ESPContainer");
    } else if (strcmp(deviceType, "RPi") == 0) {
        snprintf(to, sizeof(to), "cse-in/NRFParent/RPiContainer");
    } else {
        LOG_ERR("Invalid device type");
        return -1;
    }

    // Add simple key-value pairs
    cJSON_AddNumberToObject(root, "op", 3);
    cJSON_AddStringToObject(root, "to", to);
    cJSON_AddStringToObject(root, "fr", "CAdmin");
    cJSON_AddStringToObject(root, "rqi", "123");
    cJSON_AddStringToObject(root, "rvi", "3");

    // Create the 'pc' object
    cJSON *pc = cJSON_CreateObject();
    cJSON_AddItemToObject(root, "pc", pc);

    // Create the 'mad:dmPae' object
    cJSON *dmDIo = cJSON_CreateObject();
    cJSON_AddItemToObject(pc, "mad:dmDIo", dmDIo);

    // Add elements to 'mad:dmPae'
    cJSON_AddStringToObject(dmDIo, "name", "2.0");
    if (connected) {
        cJSON_AddNumberToObject(dmDIo, "state", 3); //active state is 3 for state.
    } else {
        cJSON_AddNumberToObject(dmDIo, "state", 1); //inactive state is 1 for state
    }
    
    if (strcmp(deviceType, "9160") == 0) {
        data_publish(&client, MQTT_QOS_1_AT_LEAST_ONCE, (uint8_t *)root->valuestring, strlen(root->valuestring), "cse-in/NRFParent/9160Container/json");
    } else if (strcmp(deviceType, "ESP32") == 0) {
       data_publish(&client, MQTT_QOS_1_AT_LEAST_ONCE, (uint8_t *)root->valuestring, strlen(root->valuestring), "cse-in/NRFParent/ESPContainer/json");
    } else if (strcmp(deviceType, "RPi") == 0) {
        data_publish(&client, MQTT_QOS_1_AT_LEAST_ONCE, (uint8_t *)root->valuestring, strlen(root->valuestring), "cse-in/NRFParent/RPiContainer/json");
    } else {
        LOG_ERR("Invalid device type");
        return -1;
    } 

    cJSON_Delete(root);
    return 0;
}
```

## src/oneM2Mmessages.h
```c
#ifndef oneM2MMessages_h
#define oneM2MMessages_h

#include "cJSON.h"
int createSubscribeMessage();

int updateFlexContainerForConnectedDevice(const char *deviceType, bool connected);

#endif /* oneM2MMessages_h */
```

## src/update.c
```c
//Written by Yuh Kurose.
//This file primarily works to watch over the update features on each device, as well as conduct the update for the 9160.

#include <zephyr/kernel.h>          // For main kernel and thread functionalities
#include <zephyr/drivers/flash.h>   // For flash memory operations
#include <zephyr/dfu/mcuboot.h>            // For MCUboot functionalities
#include <zephyr/dfu/flash_img.h>          // For flash image operations
#include <zephyr/storage/flash_map.h>      // For flash map API
#include <zephyr/logging/log.h>            // For logging
#include <zephyr/sys/reboot.h>      // For system reboot API

#include <zephyr/sys/atomic.h>     // For atomic_t
#include <stdbool.h>

#include "update.h"                 // Update header file
#include "main.h"                // Main header file for LEDs.
#define SECONDARY_PARTITION_LABEL mcuboot_secondary
#define FIXED_CHUNK_SIZE 273



LOG_MODULE_DECLARE(lte_ble_gw);
#define MAX_BINARY_CHUNK_SIZE  247

//static update_start_cb update_start;
//static char filename[128] = {0};

//static struct flash_img_context ctx;

//static bool ctx_initialized = false;
//static const struct flash_area *flash_area;

//initializing all values to zero. 
atomic_t current9160Chunk = ATOMIC_INIT(0);
atomic_t currentRPiChunk = ATOMIC_INIT(0);
atomic_t currentESP32Chunk = ATOMIC_INIT(0);
int total9160Chunks = 0;
int totalRPiChunks = 0;
int totalESP32Chunks = 0;
bool update9160Flag = false;
bool updateRPiFlag = 0;
bool updateESP32Flag = false;


//Takes decoded binary data and processes it.



int finalize_firmware_update(void) {
    int err;

    // Inform MCUboot that the update is complete
    err = boot_request_upgrade(BOOT_UPGRADE_TEST);
    if (err != 0) {
        LOG_ERR("Failed to mark update as complete: %d", err);
        // Handle error (e.g., retry, log, notify server)
        return -1;
    }

    LOG_INF("Firmware update marked as complete. Rebooting...");

    // Trigger a system reboot
    sys_reboot(SYS_REBOOT_COLD);
    //this is never reached. 
    return 0;
}

static int write_firmware_chunk_to_flash(uint32_t chunkId, const uint8_t *data, size_t len) {
    const struct flash_area *secondary_area;
    int err;
    size_t offset;

    // Open the secondary slot partition
    err = flash_area_open(FLASH_AREA_ID(SECONDARY_PARTITION_LABEL), &secondary_area);
    if (err != 0) {
        printk("Error opening secondary slot flash area: %d\n", err);
        return err;
    }

    // Calculate the offset for this chunk
    // For example, if each chunk is of fixed size, this could be:
    offset = chunkId * FIXED_CHUNK_SIZE;

    // Ensure offset + len does not exceed the partition size
    if (offset + len > secondary_area->fa_size) {
        printk("Chunk write exceeds partition size\n");
        flash_area_close(secondary_area);
        return -EINVAL;
    }

    // Write the chunk to the flash
    err = flash_area_write(secondary_area, offset, data, len);
    if (err != 0) {
        printk("Error writing to flash: %d\n", err);
    }

    // Close the flash area
    flash_area_close(secondary_area);

    return err;
}

int process_firmware_chunk(int chunk_id, const char *decoded_data, size_t decoded_len) {
    int err;
    uint32_t currentChunk;

    // Write the decoded chunk to the appropriate flash location
    err = write_firmware_chunk_to_flash(chunk_id, (const uint8_t *)decoded_data, decoded_len);
    if (err != 0) {
        printk("Error writing firmware chunk to flash: %d\n", err);
        // Handle the error (e.g., abort the update, retry, log error, etc.)
        return err;
    }

    // Read the current chunk value from the atomic variable
    currentChunk = atomic_get(&current9160Chunk);

    // Check if this is the last chunk
    if (currentChunk == total9160Chunks) {
        printk("Firmware update complete. Finalizing update...\n");
        led_condition &= ~CONDITION_FIRMWARE_UPDATING;
        led_condition |= CONDITION_FIRMWARE_DONE;
        err = finalize_firmware_update();
        if (err != 0) {
            printk("Error finalizing firmware update: %d\n", err);
            return err;
        }
    }

    return 0; // Success
}


int OTAInit(void)
{
	LOG_INF("OTA update Inititalizing...");
	//Initialize all values for firmware updates to zero.

	//This is needed so that MCUBoot won't revert the update
	boot_write_img_confirmed();

    return 0;
}
```
