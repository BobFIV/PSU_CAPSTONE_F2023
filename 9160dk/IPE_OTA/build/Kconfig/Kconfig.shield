## 9160dk/IPE_OTA/build/Kconfig/Kconfig.shield
```kconfig
osource "c:/users/yuchi/downloads/9160release/boards/shields/*/Kconfig.shield"
osource "C:/nordicsemi/v2.4.1/nrf/boards/shields/*/Kconfig.shield"
```

## 9160dk/IPE_OTA/build/Kconfig/Kconfig.shield.defconfig
```kconfig
osource "c:/users/yuchi/downloads/9160release/boards/shields/*/Kconfig.defconfig"
osource "C:/nordicsemi/v2.4.1/nrf/boards/shields/*/Kconfig.defconfig"
```

## Thingy91/lte_ble_gateway/build/Kconfig/Kconfig.shield
```kconfig
osource "c:/users/yuchi/onedrive/desktop/hci_lpuart/boards/shields/*/Kconfig.shield"
osource "c:/users/yuchi/onedrive/desktop/lte_ble_gateway/lte_ble_gateway/boards/shields/*/Kconfig.shield"
osource "C:/nordicsemi/v2.4.1/nrf/boards/shields/*/Kconfig.shield"
```

## Thingy91/lte_ble_gateway/build/Kconfig/Kconfig.shield.defconfig
```kconfig
osource "c:/users/yuchi/onedrive/desktop/hci_lpuart/boards/shields/*/Kconfig.defconfig"
osource "c:/users/yuchi/onedrive/desktop/lte_ble_gateway/lte_ble_gateway/boards/shields/*/Kconfig.defconfig"
osource "C:/nordicsemi/v2.4.1/nrf/boards/shields/*/Kconfig.defconfig"
```
