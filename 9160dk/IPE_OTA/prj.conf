## prj.conf
```kconfig
#
# Copyright (c) 2020 Nordic Semiconductor ASA
# Copyright (c) 2019 Nordic Semiconductor ASA
#
# SPDX-License-Identifier: LicenseRef-Nordic-5-Clause
#

# General config
CONFIG_NEWLIB_LIBC=y
CONFIG_NEWLIB_LIBC_FLOAT_PRINTF=y
CONFIG_ASSERT=y
CONFIG_REBOOT=y

# Logging
CONFIG_LOG=y
CONFIG_LTE_BLE_GW_LOG_LEVEL_INF=y
# CONFIG_BT_DEBUG_LOG=y

# Button and LED support
CONFIG_DK_LIBRARY=y

# Networking
CONFIG_NETWORKING=y
CONFIG_NET_NATIVE=n
CONFIG_NET_SOCKETS_OFFLOAD=y
CONFIG_NET_SOCKETS=y
CONFIG_NET_SOCKETS_POSIX_NAMES=y

# Memory
CONFIG_MAIN_STACK_SIZE=8192
CONFIG_HEAP_MEM_POOL_SIZE=24576 
CONFIG_SYSTEM_WORKQUEUE_STACK_SIZE=4096
CONFIG_BT_L2CAP_TX_MTU=247
CONFIG_BT_BUF_ACL_RX_SIZE=275
CONFIG_BT_BUF_ACL_RX_COUNT=6
CONFIG_BT_BUF_ACL_TX_COUNT=6




# Modem library
CONFIG_NRF_MODEM_LIB=y
CONFIG_NRF_MODEM_LIB_SYS_INIT=n
CONFIG_NRF_MODEM_LIB_ON_FAULT_APPLICATION_SPECIFIC=y
CONFIG_NRF_MODEM_LIB_TRACE=n

# LTE link control
CONFIG_LTE_LINK_CONTROL=y
CONFIG_LTE_NETWORK_MODE_LTE_M_GPS=y
CONFIG_LTE_AUTO_INIT_AND_CONNECT=n

# AT host
CONFIG_AT_HOST_LIBRARY=y

# Modem info
CONFIG_MODEM_INFO=y
CONFIG_MODEM_INFO_ADD_NETWORK=y


# Console
CONFIG_CONSOLE_SUBSYS=y
CONFIG_CONSOLE_GETCHAR=y

# Enable the BLE stack with GATT Client configuration
CONFIG_BT=y
CONFIG_BT_CENTRAL=y
CONFIG_BT_SMP=y
CONFIG_BT_SETTINGS=y
CONFIG_BT_GATT_CLIENT=y

# Enable the BLE modules from NCS
CONFIG_BT_NUS_CLIENT=y
CONFIG_BT_SCAN=y
CONFIG_BT_SCAN_FILTER_ENABLE=y
CONFIG_BT_SCAN_UUID_CNT=1
CONFIG_BT_GATT_DM=y

#Enable MCU boot
CONFIG_BOOTLOADER_MCUBOOT=y
CONFIG_STREAM_FLASH=y
CONFIG_IMG_MANAGER=y
CONFIG_IMG_BLOCK_BUF_SIZE=512

#Enable Base64 Encoding
CONFIG_BASE64=y



# Enable bonding

CONFIG_FLASH=y
CONFIG_FLASH_PAGE_LAYOUT=y
CONFIG_FLASH_MAP=y
CONFIG_NVS=y
CONFIG_SETTINGS=y

CONFIG_UART_INTERRUPT_DRIVEN=y

# MQTT
CONFIG_MQTT_LIB=y
CONFIG_MQTT_CLEAN_SESSION=y
CONFIG_MQTT_PUB_TOPIC="/oneM2M/req/NRFParent:NRF9160/capstone-iot/json"
CONFIG_MQTT_SUB_TOPIC="/oneM2M/resp/NRFParent:NRF9160/capstone-iot/json"
#CONFIG_MQTT_SUB_TOPIC="/ESP32/Update"
CONFIG_BUTTON_EVENT_PUBLISH_MSG="{\"op\":2,\"to\":\"cse-in/NRFParent\",\"fr\":\"CNRFParent\",\"rqi\":\"123\",\"rvi\":\"3\",\"fu\":6,\"ty\":4,\"rcn\":4}"
CONFIG_MQTT_BROKER_HOSTNAME="52.14.47.13"
CONFIG_MQTT_BROKER_PORT=1883
```

## src/main.c
```c
/*
*	Revision: Release Version 1.0
*	Last Edited: 11/15/2023
*	Author: Yuh Kurose, based on many different samples and examples from Nordic Semiconductor ASA.
*	Sponsor: Exacta Global Smart Solutions
*	See the README for more information.
 */
/*
	main.c is used for initialization of the device.
*/
#include <zephyr/kernel.h>
#include <stdio.h>
#include <zephyr/net/socket.h>


#include <string.h>
//#include <nrf_modem_at.h>
//#include <nrf_modem_gnss.h>
#include <zephyr/console/console.h>
#include <dk_buttons_and_leds.h>
#include <modem/lte_lc.h>
#include <zephyr/sys/reboot.h>
#include <modem/nrf_modem_lib.h>
#include <zephyr/logging/log.h>
#include <zephyr/net/mqtt.h>


#include "mqtt_connection.h"
#include "ble.h"
#include "mqtt_ble_pipe.h"
#include "update.h"


static K_SEM_DEFINE(lte_connected, 0, 1);
/* The mqtt client struct */
struct mqtt_client client;
/* File descriptor */
struct pollfd fds;

LOG_MODULE_REGISTER(lte_ble_gw, CONFIG_LTE_BLE_GW_LOG_LEVEL);

/* Interval in milliseconds between each time status LEDs are updated. */
#define LEDS_UPDATE_INTERVAL K_MSEC(500)

/* Interval in microseconds between each time LEDs are updated when indicating
 * that an error has occurred.
 */
#define LEDS_ERROR_UPDATE_INTERVAL 250000

#define BUTTON_1 BIT(0)
#define BUTTON_2 BIT(1)
#define SWITCH_1 BIT(2)
#define SWITCH_2 BIT(3)

#define LED_ON(x)			(x)
#define LED_BLINK(x)		((x) << 8)
#define LED_GET_ON(x)		((x) & 0xFF)
#define LED_GET_BLINK(x)	(((x) >> 8) & 0xFF)

/* Interval in milliseconds after the device will retry cloud connection
 * if the event NRF_CLOUD_EVT_TRANSPORT_CONNECTED is not received.
 */
#define RETRY_CONNECT_WAIT K_MSEC(90000)

//To do: Update LEDs.
enum {
	LEDS_INITIALIZING       = LED_ON(0),
	LEDS_LTE_CONNECTING     = LED_BLINK(DK_LED3_MSK),
	LEDS_LTE_CONNECTED      = LED_ON(DK_LED3_MSK),
	LEDS_CLOUD_CONNECTING   = LED_BLINK(DK_LED4_MSK),
	LEDS_CLOUD_PAIRING_WAIT = LED_BLINK(DK_LED3_MSK | DK_LED4_MSK),
	LEDS_CLOUD_CONNECTED    = LED_ON(DK_LED4_MSK),
	LEDS_ERROR              = LED_ON(DK_ALL_LEDS_MSK)
} display_state;




/* Structures for work */
struct k_work_delayable leds_update_work;
struct k_work_delayable periodic_transmit_work;
struct k_work_delayable periodic_publish_work;




enum error_type {
	ERROR_NRF_CLOUD,
	ERROR_MODEM_RECOVERABLE,
};

/* Forward declaration of functions. */
static void work_init(void);

static void lte_handler(const struct lte_lc_evt *const evt)
{
     switch (evt->type) {
     case LTE_LC_EVT_NW_REG_STATUS:
        if ((evt->nw_reg_status != LTE_LC_NW_REG_REGISTERED_HOME) &&
            (evt->nw_reg_status != LTE_LC_NW_REG_REGISTERED_ROAMING)) {
            break;
        }
		LOG_INF("Network registration status: %s",
				evt->nw_reg_status == LTE_LC_NW_REG_REGISTERED_HOME ?
				"Connected - home network" : "Connected - roaming");
		k_sem_give(&lte_connected);
        break;
	case LTE_LC_EVT_RRC_UPDATE:
		LOG_INF("RRC mode: %s", evt->rrc_mode == LTE_LC_RRC_MODE_CONNECTED ?
				"Connected" : "Idle");
		break;
     default:
             break;
     }
}


/**@brief nRF Cloud error handler. */
void error_handler(enum error_type err_type, int err)
{
	if (err_type == ERROR_NRF_CLOUD) {
		int err;

		/* Turn off and shutdown modem */
		k_sched_lock();
		err = lte_lc_power_off();
		__ASSERT(err == 0, "lte_lc_power_off failed: %d", err);
		nrf_modem_lib_shutdown();
	}

#if !defined(CONFIG_DEBUG)
	sys_reboot(SYS_REBOOT_COLD);
#else
	uint8_t led_pattern;

	switch (err_type) {
	case ERROR_NRF_CLOUD:
		/* Blinking all LEDs ON/OFF in pairs (1 and 4, 2 and 3)
		 * f there is an application error.
		 */
		led_pattern = DK_LED1_MSK | DK_LED4_MSK;
		LOG_ERR("Error of type ERROR_NRF_CLOUD: %d", err);
		break;
	case ERROR_MODEM_RECOVERABLE:
		/* Blinking all LEDs ON/OFF in pairs (1 and 3, 2 and 4)
		 * if there is a recoverable error.
		 */
		led_pattern = DK_LED1_MSK | DK_LED3_MSK;
		LOG_ERR("Error of type ERROR_MODEM_RECOVERABLE: %d", err);
		break;
	default:
		/* Blinking all LEDs ON/OFF in pairs (1 and 2, 3 and 4)
		 * undefined error.
		 */
		led_pattern = DK_LED1_MSK | DK_LED2_MSK;
		break;
	}

	while (true) {
		dk_set_leds(led_pattern & 0x0f);
		k_busy_wait(LEDS_ERROR_UPDATE_INTERVAL);
		dk_set_leds(~led_pattern & 0x0f);
		k_busy_wait(LEDS_ERROR_UPDATE_INTERVAL);
	}
#endif /* CONFIG_DEBUG */
}

/**@brief Modem fault handler. */
void nrf_modem_fault_handler(struct nrf_modem_fault_info *fault_info)
{
	error_handler(ERROR_MODEM_RECOVERABLE, (int)fault_info->reason);
}

/**@brief Update LEDs state. */
static void leds_update(struct k_work *work)
{
	static bool led_on;
	static uint8_t current_led_on_mask;
	uint8_t led_on_mask = current_led_on_mask;

	ARG_UNUSED(work);

	/* Reset LED3 and LED4. */
	led_on_mask &= ~(DK_LED3_MSK | DK_LED4_MSK);

	/* Set LED3 and LED4 to match current state. */
	led_on_mask |= LED_GET_ON(display_state);

	led_on = !led_on;
	if (led_on) {
		led_on_mask |= LED_GET_BLINK(display_state);
	} else {
		led_on_mask &= ~LED_GET_BLINK(display_state);
	}

	if (led_on_mask != current_led_on_mask) {
		dk_set_leds(led_on_mask);
		current_led_on_mask = led_on_mask;
	}

	k_work_schedule(&leds_update_work, LEDS_UPDATE_INTERVAL);
}


/**@brief Callback for button events from the DK buttons and LEDs library. */
static void button_handler(uint32_t buttons, uint32_t has_changed)
{
	switch (has_changed) {
	case DK_BTN1_MSK:
		/* STEP 7.2 - When button 1 is pressed, call data_publish() to publish a message */
		if (buttons & DK_BTN1_MSK){
			int err = data_publish(&client, MQTT_QOS_1_AT_LEAST_ONCE,
				   CONFIG_BUTTON_EVENT_PUBLISH_MSG, sizeof(CONFIG_BUTTON_EVENT_PUBLISH_MSG), "/oneM2M/req/NRFParent:NRF9160/capstone-iot/json"); //if this doesn't work, add -1 back to sizeof. 
			if (err) {
				LOG_INF("Failed to send message, %d", err);
				return;
			}
		}
		break;
	}
}

/**@brief Initializes and submits delayed work. */
static void work_init(void)
{
	k_work_init_delayable(&leds_update_work, leds_update);
	k_work_schedule(&leds_update_work, LEDS_UPDATE_INTERVAL);
	k_work_init_delayable(&periodic_transmit_work, transmit_aggregated_data);
	k_work_schedule(&periodic_transmit_work, K_MSEC(10000));
	k_work_init_delayable(&periodic_publish_work, publish_aggregated_data);
	k_work_schedule(&periodic_publish_work, K_MSEC(10000));
}

/**@brief Configures modem to provide LTE link. Blocks until link is
 * successfully established.
 */

static int modem_configure(void)
{
	int err;

	LOG_INF("Initializing modem library");

	err = nrf_modem_lib_init();
	if (err) {
		LOG_ERR("Failed to initialize the modem library, error: %d", err);
		return err;
	}

	LOG_INF("Connecting to LTE network");

	err = lte_lc_init_and_connect_async(lte_handler);
	if (err) {
		LOG_INF("Modem could not be configured, error: %d", err);
		return err;
	}

	k_sem_take(&lte_connected, K_FOREVER);
	LOG_INF("Connected to LTE network");
	display_state = LEDS_LTE_CONNECTED;

	return 0;
}

int main(void)
{
	int err;
	uint32_t connect_attempt = 0;
	LOG_INF("Welcome to PSU CAPSTONE FALL 2023");

	if (dk_leds_init() != 0) {
		LOG_ERR("Failed to initialize the LED library");
	}

	err = modem_configure();
	if (err) {
		LOG_ERR("Failed to configure the modem");
		return 0;
	}

	if (dk_buttons_init(button_handler) != 0) {
		LOG_ERR("Failed to initialize the buttons library");
	}

	err = client_init(&client);
	if (err) {
		LOG_ERR("Failed to initialize MQTT client: %d", err);
		return 0;
	}
	work_init();		//Initalize work: Uplink Aggregator publish, Downlink transmit and LED functions.
	err = ble_init();		    //Initializes bluetooth (ble.c)
	if (err) {
		LOG_ERR("Failed to initialize BLE: %d", err);
		return 0;
	}
	err = OTAInit();		//Initializes OTA update (update.c)
	if (err) {
		LOG_ERR("Failed to initialize OTA: %d", err);
		return 0;
	}
do_connect:
	if (connect_attempt++ > 0) {
		LOG_INF("Reconnecting in %d seconds...",
			CONFIG_MQTT_RECONNECT_DELAY_S);
		k_sleep(K_SECONDS(CONFIG_MQTT_RECONNECT_DELAY_S));
	}
	err = mqtt_connect(&client);
	if (err) {
		LOG_ERR("Error in mqtt_connect: %d", err);
		goto do_connect;
	}

	err = fds_init(&client,&fds);
	if (err) {
		LOG_ERR("Error in fds_init: %d", err);
		return 0;
	}

	while (1) {
		err = poll(&fds, 1, mqtt_keepalive_time_left(&client));
		if (err < 0) {
			LOG_ERR("Error in poll(): %d", errno);
			break;
		}

		err = mqtt_live(&client);
		if ((err != 0) && (err != -EAGAIN)) {
			LOG_ERR("Error in mqtt_live: %d", err);
			break;
		}

		if ((fds.revents & POLLIN) == POLLIN) {
			err = mqtt_input(&client);
			if (err != 0) {
				LOG_ERR("Error in mqtt_input: %d", err);
				break;
			}
		}

		if ((fds.revents & POLLERR) == POLLERR) {
			LOG_ERR("POLLERR");
			break;
		}

		if ((fds.revents & POLLNVAL) == POLLNVAL) {
			LOG_ERR("POLLNVAL");
			break;
		}
	}

	LOG_INF("Disconnecting MQTT client");

	err = mqtt_disconnect(&client);
	if (err) {
		LOG_ERR("Could not disconnect MQTT client: %d", err);
	}
	goto do_connect;
	LOG_ERR("How'd we get here?");
	/* This is never reached */
	return 0;
}
```

## src/aggregator.h
```c
/*
 * Copyright (c) 2018 Nordic Semiconductor ASA
 *
 * SPDX-License-Identifier: LicenseRef-Nordic-5-Clause
 */

#ifndef _AGGREGATOR_H_
#define _AGGREGATOR_H_
#include <stdint.h>


/*
 * Simple aggregator module which can have sensordata added and retrieved in a
 * FIFO fashion. The queue allows TLD formated data to be aggregated from
 * sensors in a FIFO fashion. When some event in the future causes data
 * transfer to start, the most recent X datapoints (determined by ENTRY_MAX_SIZE
 * and HEAP_MEM_POOL_SIZE) can be transferred.
 *
 * Note: The module is single instance to allow simple global access to the
 * data.
 * 
 * This is edited from the original sample program.
 */


#define ENTRY_MAX_SIZE (247)				//This is probably wrong. Will have to change later.
#define FIFO_MAX_ELEMENT_COUNT 12

enum uplink_data_packet_type {						//Data types for going up are text and image.
	uplink_FIRMWARE_ERROR,
    uplink_FIRMWARE_ACK,
    uplink_FIRMWARE_VERSION,
    //uplink_IMAGE,
    uplink_TRAIN_LOCATION,
};
enum ble_source {
	SOURCE_ESP32,
	SOURCE_RaspberryPi,
};

struct uplink_data_packet {						//This is the data structure that will be used to store data going upwards to MQTT.
	uint8_t length;
	enum uplink_data_packet_type type;
	enum ble_source source;
	uint8_t data[ENTRY_MAX_SIZE];
};

enum downlink_data_packet_type {					//Data types for going down are firmware update and image.
	downlink_TEXT,
	FIRMWARE_UPDATE,
};
enum ble_destination {					//Destination for data going down is either ESP32 or Raspberry Pi.
	DESTINATION_ESP32,					
	DESTINATION_RaspberryPi,
	DESTINATION_UNKNOWN,
};



struct downlink_data_packet {				//This is the data structure that is used to store data going downwards to BLE.
	uint8_t length;
	enum downlink_data_packet_type type;
	enum ble_destination destination;
	int chunk_id;
	char data[ENTRY_MAX_SIZE];			//May be a Base 64 encoded firmware, Image, or Text
	uint32_t checksum;
};



int aggregator_init(void);

int uplink_aggregator_put(struct uplink_data_packet data);

int uplink_aggregator_get(struct uplink_data_packet *data);

int downlink_aggregator_put(struct downlink_data_packet data);

int downlink_aggregator_get(struct downlink_data_packet *data);

void aggregator_clear(void);

int aggregator_element_count_get(void);

#endif /* _AGGREGATOR_H_ */
```

## src/ble.c
```c
/*
 * Copyright (c) 2018 Nordic Semiconductor ASA
 *
 * SPDX-License-Identifier: LicenseRef-Nordic-5-Clause
 */

#include <zephyr/kernel.h>

#include <zephyr/bluetooth/bluetooth.h>
#include <zephyr/bluetooth/gatt.h>
#include <zephyr/bluetooth/uuid.h>
#include <zephyr/bluetooth/conn.h>
#include <zephyr/bluetooth/hci.h>

#include <bluetooth/gatt_dm.h>
#include <bluetooth/scan.h>
#include <bluetooth/conn_ctx.h>
#include <bluetooth/services/nus.h>
#include <bluetooth/services/nus_client.h>

#include <zephyr/settings/settings.h>
#include <dk_buttons_and_leds.h>
#include <zephyr/sys/byteorder.h>

#include <errno.h>
#include <stdio.h>
#include <zephyr/logging/log.h>
#include "aggregator.h"
#include "ble.h"

static struct bt_conn *default_conn;
static struct bt_nus_client default_nus_client;

K_SEM_DEFINE(nus_write_sem, 0, 1);


LOG_MODULE_DECLARE(lte_ble_gw);
//BLE one-byte headers for BLE communication used in receiver.
#define FIRMWARE_ERROR   0x01
#define FIRMWARE_ACK     0x02
#define FIRMWARE_VERSION 0x03
#define IMAGE            0x04
#define TRAIN_LOCATION   0x05

//#define BT_UUID_NUS_SERVICE BT_UUID_DECLARE_128(BT_UUID_128_ENCODE(0x00000001, 0x710e, 0x4a5b, 0x8d75, 0x3e5b444bc3cf))
//#define BT_UUID_NUS_SERVICE BT_UUID_DECLARE_128(BT_UUID_128_ENCODE(0x6E400001, 0xB5A3, 0xF393, 0xE0A9, 0xE50E24DCCA9E))


#define MAX_CONNECTED_DEVICES 5

#define BT_NAME_MAX_LEN 248	//super overkill but this is the default, I suppose?
/*
struct ble_device {   // device connected struct.
    struct bt_conn *conn;
    enum ble_destination destination;       // device name: i.e. Rasperry Pi, ESP32, etc.
    struct bt_nus_client *nus_client;        // NUS client instance for the device
};
*/

//static struct ble_device devices_list[MAX_CONNECTED_DEVICES];

struct bt_conn* get_conn_from_destination(enum ble_destination destination) {
    /*
    for (int i = 0; i < MAX_CONNECTED_DEVICES; i++) {
        if (devices_list[i].destination == destination) {
            return devices_list[i].conn;
        }
    }
    return NULL; // No connection found for the given destination
    */
    return default_conn;
}
/*
enum ble_destination get_destination_from_conn(struct bt_conn *conn) {
    for (int i = 0; i < MAX_CONNECTED_DEVICES; i++) {
		if (devices_list[i].conn == conn) {
			return devices_list[i].destination;
		}
	}
	return DESTINATION_UNKNOWN; // No destination found for the given connection
}
*/
//Function prototyping for the device name function.
char *get_device_name(struct bt_conn *conn);

/*
static void setup_connection(struct bt_conn *conn, struct bt_nus_client *nus) {
    for (int i = 0; i < MAX_CONNECTED_DEVICES; i++) {
        if (!devices_list[i].conn) {
            devices_list[i].conn = conn;
            devices_list[i].destination = DESTINATION_UNKNOWN;
			devices_list[i].nus_client = nus;

            LOG_INF("Connection in array initialized.");
            break;
        }
    }
}
*/
/*
static void remove_connection(struct bt_conn *conn) {
    for (int i = 0; i < MAX_CONNECTED_DEVICES; i++) {
        if (devices_list[i].conn == conn) {
            devices_list[i].conn = NULL;
            devices_list[i].destination = DESTINATION_UNKNOWN; // Set to an "unknown" or "unset" value
            break;
        }
    }
}
*/
static void ble_data_sent(uint8_t err, const uint8_t *const data, uint16_t len)
{

	k_sem_give(&nus_write_sem);

	if (err) {
		LOG_WRN("ATT error code: 0x%02X", err);
	}
}



int ble_transmit(struct bt_conn *conn, uint8_t *data, size_t length) {
    LOG_INF("Transmit called...");

    if (!data || !length) {
        return -EINVAL;
    }
    if (!conn) {
        LOG_INF("No connection found for destination");
        return -EINVAL;
    }
    int err = bt_nus_client_send(&default_nus_client, data, length);
    if (err) {
        LOG_ERR("Failed to send data over BLE using NUS: %d", err);
        return err;
    }

    return 0;
}

static void discovery_completed(struct bt_gatt_dm *dm, void *context)
{
    struct bt_nus_client *nus = context;
    LOG_INF("Service discovery completed");
    bt_gatt_dm_data_print(dm);

	bt_nus_handles_assign(dm, nus);
	bt_nus_subscribe_receive(nus);


    bt_gatt_dm_data_release(dm);

    
    //restart scanning
    int err = bt_scan_start(BT_SCAN_TYPE_SCAN_ACTIVE);
    if (err) {
        LOG_ERR("Scanning failed to start, err %d", err);
        return;
    } else {
        LOG_INF("Scanning started again after discovery.");
    }

}


/*
char *get_device_name(struct bt_conn *conn) {
    static char name[BT_NAME_MAX_LEN + 1]; // +1 for null-terminator
    struct bt_conn_info info;

    if (!conn) {
        return NULL;
    }

    if (bt_conn_get_info(conn, &info) < 0) {
        return NULL;
    }

    // Assuming you're dealing with LE connections
    if (info.type == BT_CONN_TYPE_LE) {
        strncpy(name, info.le.dst->a.val, BT_NAME_MAX_LEN);
        name[BT_NAME_MAX_LEN] = '\0'; // Ensure null-termination
        return name;
    }

    return NULL;
}

*/

static void discovery_service_not_found(struct bt_conn *conn,
					void *context)
{
	LOG_ERR("Service not found");
}

static void discovery_error(struct bt_conn *conn,
			    int err,
			    void *context)
{
	LOG_WRN("Error while discovering GATT database: (%d)", err);
}

struct bt_gatt_dm_cb discovery_cb = {
	.completed         = discovery_completed,
	.service_not_found = discovery_service_not_found,
	.error_found       = discovery_error,
};


static void gatt_discover(struct bt_conn *conn)
{
	int err;

	if (conn != default_conn) {
		return;
	}

	err = bt_gatt_dm_start(conn,
			       BT_UUID_NUS_SERVICE,
			       &discovery_cb,
			       &default_nus_client);
	if (err) {
		LOG_ERR("could not start the discovery procedure, error "
			"code: %d", err);
	}
}

static void exchange_func(struct bt_conn *conn, uint8_t err, struct bt_gatt_exchange_params *params)
{
	if (!err) {
		LOG_INF("exchange_func succesfully executed.");
        uint16_t mtu = bt_gatt_get_mtu(conn);
        LOG_INF("Negotiated MTU size: %u", mtu);
	} else {
		LOG_WRN("MTU exchange failed (err %" PRIu8 ")", err);
	}
}

static void connected(struct bt_conn *conn, uint8_t conn_err) {
    char addr[BT_ADDR_LE_STR_LEN];
    int err;

    bt_addr_le_to_str(bt_conn_get_dst(conn), addr, sizeof(addr));

    if (conn_err) {
        LOG_ERR("Failed to connect to %s (%d)", addr, conn_err);

        if (default_conn == conn) {
            bt_conn_unref(default_conn);
            default_conn = NULL;

            err = bt_scan_start(BT_SCAN_TYPE_SCAN_ACTIVE);
            if (err) {
                LOG_ERR("Scanning failed to start (err %d)", err);
            }
        }

        LOG_ERR("Failed to connect to %s (%u)", addr, conn_err);
        return;
    }

    LOG_INF("Connected: %s", addr);
    LOG_INF("Called MTU exchange function");
    static struct bt_gatt_exchange_params exchange_params;
    exchange_params.func = exchange_func;

    LOG_INF("Called bt_gatt_exchange_mtu");
    LOG_INF("exchange_params.func address: 0x%08x", (uint32_t) exchange_params.func);
    LOG_INF("Connection pointer: 0x%08x", (uint32_t) conn);
    err = bt_gatt_exchange_mtu(conn, &exchange_params);
    if (err) {
        LOG_WRN("MTU exchange failed (err %d)", err);
    }

    //k_sleep(K_MSEC(5000));  // Wait for 5 seconds before starting the discovery

    
    
    
    LOG_INF("Called Security function");
    err = bt_conn_set_security(conn, BT_SECURITY_L1);
    if (err) {
        LOG_WRN("Failed to set security: %d", err);
        gatt_discover(conn);
    }
    LOG_INF("Security Set. Starting Discovery...");
    
    LOG_INF("Calling bt_gatt_dm_start");

    err = bt_gatt_dm_start(conn, BT_UUID_NUS_SERVICE, &discovery_cb, &default_nus_client);
    if (err) {
        LOG_ERR("Could not start service discovery, err %d", err);
    } else {
       // k_sleep(K_MSEC(100));
        gatt_discover(conn);
    }

   // k_sleep(K_MSEC(500));  // Another 500 milliseconds delay after discovery

    err = bt_scan_stop();
    if ((!err) && (err != -EALREADY)) {
        LOG_ERR("Stop LE scan failed (err %d)", err);
    }
    default_conn = conn;
}

static void disconnected(struct bt_conn *conn, uint8_t reason) {
    char addr[BT_ADDR_LE_STR_LEN];
    int err;

    bt_addr_le_to_str(bt_conn_get_dst(conn), addr, sizeof(addr));

    LOG_INF("Disconnected: %s, Reason: %u", addr, reason);
    //remove_connection(conn);  // Remove the connection from the list

    if (default_conn != conn) {
        return;
    }

    bt_conn_unref(default_conn);
    default_conn = NULL;

    
    err = bt_scan_start(BT_SCAN_TYPE_SCAN_ACTIVE);
    if (err) {
        LOG_ERR("Scanning failed to start (err %d)", err);
    }
    LOG_INF("Scan started again due to disconnect.");
}
static void security_changed(struct bt_conn *conn, bt_security_t level,
			     enum bt_security_err err)
{
	char addr[BT_ADDR_LE_STR_LEN];

	bt_addr_le_to_str(bt_conn_get_dst(conn), addr, sizeof(addr));

	if (!err) {
		LOG_INF("Security changed: %s level %u", addr, level);
	} else {
		LOG_WRN("Security failed: %s level %u err %d", addr,
			level, err);
	}

	gatt_discover(conn);
}



BT_CONN_CB_DEFINE(conn_callbacks) = {
	.connected = connected,
	.disconnected = disconnected,
	.security_changed = security_changed
};


void scan_filter_match(struct bt_scan_device_info *device_info,
		       struct bt_scan_filter_match *filter_match,
		       bool connectable)
{
	char addr[BT_ADDR_LE_STR_LEN];

	bt_addr_le_to_str(device_info->recv_info->addr, addr, sizeof(addr));

	LOG_INF("Device found: %s", addr);
}

void scan_connecting_error(struct bt_scan_device_info *device_info)
{
	LOG_ERR("Connection to peer failed!");
}

BT_SCAN_CB_INIT(scan_cb, scan_filter_match, NULL, scan_connecting_error, NULL);

static int scan_init(void) {
    int err = 0;

    struct bt_le_scan_param scan_param = {
        .type = BT_LE_SCAN_TYPE_ACTIVE,
        .options = BT_LE_SCAN_OPT_FILTER_DUPLICATE,
        .interval = 0x0100,
        .window = 0x0050,
    };

    struct bt_scan_init_param scan_init = {
        .connect_if_match = 1,
        .scan_param = &scan_param,
        .conn_param = BT_LE_CONN_PARAM_DEFAULT,
    };

    bt_scan_init(&scan_init);
    bt_scan_cb_register(&scan_cb);

    // Add filter for ESP32 service
    //err = bt_scan_filter_add(BT_SCAN_FILTER_TYPE_UUID, BT_UUID_ESP32_SERVICE);
    err = bt_scan_filter_add(BT_SCAN_FILTER_TYPE_UUID, BT_UUID_NUS_SERVICE);
    if (err) {
        LOG_ERR("Scanning filters for ESP32 service cannot be set");
        return err;
    }

	// Add filter for Raspberry Pi Service service
	/*
	err = bt_scan_filter_add(BT_SCAN_FILTER_TYPE_UUID, BT_UUID_rPI_SERVICE);
    if (err) {
        LOG_ERR("Scanning filters for rPI service cannot be set");
        return;
    }
	*/
    

    err = bt_scan_filter_enable(BT_SCAN_UUID_FILTER, false);
    if (err) {
        LOG_ERR("Filters cannot be turned on (err %d)", err);
        return err;
    }

	return err;

}


static void auth_cancel(struct bt_conn *conn)
{
	char addr[BT_ADDR_LE_STR_LEN];

	bt_addr_le_to_str(bt_conn_get_dst(conn), addr, sizeof(addr));

	LOG_INF("Pairing cancelled: %s", addr);
}



static void pairing_complete(struct bt_conn *conn, bool bonded)
{
	char addr[BT_ADDR_LE_STR_LEN];

	bt_addr_le_to_str(bt_conn_get_dst(conn), addr, sizeof(addr));

	LOG_INF("Pairing completed: %s, bonded: %d", addr, bonded);
}


static void pairing_failed(struct bt_conn *conn, enum bt_security_err reason)
{
	char addr[BT_ADDR_LE_STR_LEN];

	bt_addr_le_to_str(bt_conn_get_dst(conn), addr, sizeof(addr));

	LOG_WRN("Pairing failed conn: %s, reason %d", addr, reason);
}


static struct bt_conn_auth_cb conn_auth_callbacks = {
	.cancel = auth_cancel,
};

static struct bt_conn_auth_info_cb conn_auth_info_callbacks = {
	.pairing_complete = pairing_complete,
	.pairing_failed = pairing_failed
};


static uint8_t ble_data_received(struct bt_nus_client *nus, const uint8_t *data, uint16_t len)
{
    //Handles data received via Bluetooth.
    /*
    Data consists of:
    1. Firmware error messages from a device to respective topic in MQTT (/ESP32/Update or /RaspberryPi/Update)
    2. Firmware Update Ready (ACK) messages from a device to respective topic in MQTT (/ESP32/Update or /RaspberryPi/Update)
    3. Firmware versions from initial connection on each device. This will be package in oneM2M and sent as an UPDATE call to the ACME CSE.
    4. Images going from ESP32 to rPI
    5. Location of the train from the rPI to Django
    #define FIRMWARE_ERROR   0x01
    #define FIRMWARE_ACK     0x02
    #define FIRMWARE_VERSION 0x03
    #define IMAGE            0x04
    #define TRAIN_LOCATION   0x05
    */
    ARG_UNUSED(nus);

    LOG_INF("Data received via NUS...");
    if (len > 0) {
        LOG_HEXDUMP_INF(data, len, "Received data:");
        int err = 0;
        // Check the first byte to determine the data type
        uint8_t data_type = data[0];
        struct uplink_data_packet data_packet;
        data_packet.source = SOURCE_ESP32; // This is just a placeholder. 
        //#TO-DO The source will be determined by the device name 
        data_packet.length = MIN(len - 1, ENTRY_MAX_SIZE); // Subtract 1 to exclude the header
        memcpy(data_packet.data, data + 1, data_packet.length); // Start copying from data + 1
        switch (data_type) {
            case FIRMWARE_ERROR:
                data_packet.type = uplink_FIRMWARE_ERROR;
                err = uplink_aggregator_put(data_packet);
                if (err) {
                    LOG_ERR("Failed to put data into aggregator, err %d", err);
                }
                break;
            case FIRMWARE_ACK:
                data_packet.type = uplink_FIRMWARE_ACK;
                err = uplink_aggregator_put(data_packet);
                if (err) {
                    LOG_ERR("Failed to put data into aggregator, err %d", err);
                }
                break;
            case FIRMWARE_VERSION:
                data_packet.type = uplink_FIRMWARE_VERSION;
                err = uplink_aggregator_put(data_packet);
                if (err) {
                    LOG_ERR("Failed to put data into aggregator, err %d", err);
                }
                break;
            case IMAGE:
                //transfer_image_to_rpi(data + 1, len - 1);               //This must be resent over BLE to the rPI.
                break;
            case TRAIN_LOCATION:
                data_packet.type = uplink_TRAIN_LOCATION;
                err = uplink_aggregator_put(data_packet);
                if (err) {
                    LOG_ERR("Failed to put data into aggregator, err %d", err);
                }          
                break;
            default:
                LOG_ERR("Unknown data type received: %d", data_type);
                break;
        }
    } else {
        LOG_DBG("Notification with 0 length");
    }

    return BT_GATT_ITER_CONTINUE;
}


static int nus_client_init(void)
{
	int err;
	struct bt_nus_client_init_param init = {
		.cb = {
			.received = ble_data_received,
			.sent = ble_data_sent,
		}
	};

	err = bt_nus_client_init(&default_nus_client, &init);
	if (err) {
		LOG_ERR("NUS Client initialization failed (err %d)", err);
		return err;
	}

	LOG_INF("Default NUS Client module initialized");
	return err;
}



int ble_init(void)
{
	int err;

	LOG_INF("Initializing Bluetooth..");

	err = bt_conn_auth_cb_register(&conn_auth_callbacks);
	if (err) {
		LOG_ERR("Failed to register authorization callbacks.");
		return err;
	}

	err = bt_conn_auth_info_cb_register(&conn_auth_info_callbacks);
	if (err) {
		printk("Failed to register authorization info callbacks.\n");
		return err;
	}

	err = bt_enable(NULL);
	if (err) {
		LOG_ERR("Bluetooth init failed (err %d)", err);
		return err;
	}

	LOG_INF("Bluetooth initialized");

	if (IS_ENABLED(CONFIG_SETTINGS)) {
		settings_load();
	}


	err = scan_init();
	if (err != 0) {
		LOG_ERR("scan_init failed (err %d)", err);
		return err;
	}
	
	err = nus_client_init(); // NULL for default callbacks, or you can provide your own
	if (err) {
		LOG_ERR("Failed to initialize default NUS client (err %d)", err);
		return err;
	}
	err = bt_scan_start(BT_SCAN_TYPE_SCAN_ACTIVE);
    if (err) {
        LOG_ERR("Scanning failed to start, err %d", err);
        return err;
    }

    LOG_INF("Scanning...");
	
    return err;
}
```

## src/mqtt_ble_pipe.c
```c
#include <string.h>
#include <stdbool.h>
#include <net/nrf_cloud.h>
#include <zephyr/logging/log.h>
#include <stdio.h>


#include "aggregator.h"
#include "mqtt_connection.h"
#include "ble.h"
#include "mqtt_ble_pipe.h"
#include "main.h"
#include "cJSON.h"

LOG_MODULE_DECLARE(lte_ble_gw);


#define SERIALIZED_DATA_MAX_SIZE 300  // Some number. Probably wrong. To-Do: Update.


char *serialize_uplink_packet_to_json(const struct uplink_data_packet *packet) {
    cJSON *root = cJSON_CreateObject();
    if (root == NULL) {
        LOG_ERR("Failed to create JSON object");
        return NULL;
    }

    switch (packet->type) {
        case uplink_FIRMWARE_ERROR:
            
            cJSON_AddStringToObject(root, "Firmware Error", (char *)packet->data);
            break;

        case uplink_FIRMWARE_ACK:
            
            cJSON_AddStringToObject(root, "Firmware ACK", (char *)packet->data);
            break;

        case uplink_FIRMWARE_VERSION:
            // TODO: Format the firmware version into oneM2M format
            cJSON_AddStringToObject(root, "Firmware Version", (char *)packet->data);
            break;

        case uplink_TRAIN_LOCATION:
            cJSON_AddStringToObject(root, "type", "Train Location");
            cJSON_AddStringToObject(root, "location", (char *)packet->data);
            break;

        default:
            LOG_ERR("Unsupported packet type");
            cJSON_Delete(root);
            return NULL;
    }

    char *jsonString = cJSON_PrintUnformatted(root);
    cJSON_Delete(root);

    return jsonString; // Caller must free this memory with cJSON_free()
}

const char* setTopic(enum uplink_data_packet_type packetType, enum ble_source source) {
    switch (packetType) {
        case uplink_FIRMWARE_ERROR:
        case uplink_FIRMWARE_ACK:
            if (source == SOURCE_ESP32) {
                return "/ESP32/Update";
            } else if (source == SOURCE_RaspberryPi) {
                return "/RaspberryPi/Update";
            }
            break;

        case uplink_FIRMWARE_VERSION:
            // Assuming oneM2M updates are sent to a specific topic
            return "/oneM2M/resp/capstone-iot/NRFParent/json";  // Modify as needed for your CSE topic

        case uplink_TRAIN_LOCATION:
            // Location data from Raspberry Pi to Django
            return "/RaspberryPi/Data";


        default:
            LOG_ERR("Unknown data type");
            break;
    }

    // Default topic or error handling
    return "/Unknown/Topic";
}



void publish_aggregated_data(struct k_work *work) {
    ARG_UNUSED(work);
    struct k_work_delayable *dwork = CONTAINER_OF(work, struct k_work_delayable, work);

    struct uplink_data_packet data_packet;

    while (uplink_aggregator_get(&data_packet) == 0) {
        // Serialize data packet to JSON
        char *json_payload = serialize_uplink_packet_to_json(&data_packet);
        if (json_payload == NULL) {
            continue;
        }

        // Determine the appropriate topic
        const char *topic = setTopic(data_packet.type, data_packet.source);

        if (topic == NULL) {
            LOG_ERR("Unknown data source");
            cJSON_free(json_payload);
            continue;
        }

        // Publish the JSON payload
        if (data_publish(&client, MQTT_QOS_1_AT_LEAST_ONCE, json_payload, strlen(json_payload), topic) != 0) {
            LOG_ERR("Failed to publish data to topic %s", topic);
        }

        cJSON_free(json_payload);
    }

    k_work_reschedule(dwork, K_MSEC(100));
}

char *create_json_message_for_ble(const struct downlink_data_packet *packet) {
    if (!packet) {
        return NULL;
    }

    cJSON *root = cJSON_CreateObject();
    if (!root) {
        // Handle error
        return NULL;
    }

    switch (packet->type) {
        case FIRMWARE_UPDATE:
            cJSON_AddNumberToObject(root, "I", packet->chunk_id); // Assuming chunk_id is a field in your struct
            cJSON_AddStringToObject(root, "D", packet->data);
            char checksumStr[20]; // Make sure this buffer is large enough to hold the checksum as a string
            snprintf(checksumStr, sizeof(checksumStr), "%u", packet->checksum);
            cJSON_AddStringToObject(root, "C", checksumStr);
            break;
        case downlink_TEXT:
            cJSON_AddStringToObject(root, "Message", packet->data);
            break;
        default:
            cJSON_Delete(root);
            return NULL;
    }

    char *json_string = cJSON_PrintUnformatted(root);
    cJSON_Delete(root);
    return json_string; // Remember to free this string after use
}


void transmit_aggregated_data(struct k_work *work) {
    struct k_work_delayable *dwork = CONTAINER_OF(work, struct k_work_delayable, work);

    struct downlink_data_packet packet;
    while (downlink_aggregator_get(&packet) == 0) {
        char *json_message = create_json_message_for_ble(&packet);
        if (json_message == NULL) {
            continue;
        }
        if (packet.destination == DESTINATION_ESP32)
        {

        }
        else if (packet.destination == DESTINATION_RaspberryPi)
        {

        }
        else
        {
            LOG_ERR("Unknown destination");
            free(json_message);
            continue;
        }
        struct bt_conn *target_conn = get_conn_from_destination(packet.destination); //currently unused, sets default_conn :) 
        if (target_conn) {
            ble_transmit(target_conn, (uint8_t *)json_message, strlen(json_message));
        } else {
            LOG_ERR("No connection found for destination %d", packet.destination);
        }

        free(json_message);
    }

    k_work_reschedule(dwork, K_MSEC(100));
}
```

## src/mqtt_ble_pipe.h
```c
#ifndef _MQTT_BLE_PIPE_H_
#define _MQTT_BLE_PIPE_H_

void publish_aggregated_data(struct k_work *work);

void transmit_aggregated_data(struct k_work *work);

size_t serialize_downlink_data_packet(const struct downlink_data_packet *packet, uint8_t *buffer, size_t buffer_size);

#endif /* _MQTT_BLE_PIPE_H_ */
```

## src/update.c
```c
//Written by Yuh Kurose.
//This file primarily works to watch over the update features on each device, as well as conduct the update for the 9160.

#include <zephyr/kernel.h>          // For main kernel and thread functionalities
#include <zephyr/drivers/flash.h>   // For flash memory operations
#include <zephyr/dfu/mcuboot.h>            // For MCUboot functionalities
#include <zephyr/dfu/flash_img.h>          // For flash image operations
#include <zephyr/storage/flash_map.h>      // For flash map API
#include <zephyr/logging/log.h>            // For logging
#include <zephyr/sys/reboot.h>      // For system reboot API

#include <zephyr/sys/atomic.h>     // For atomic_t
#include <stdbool.h>

#include "update.h"                 // Update header file

#define SECONDARY_PARTITION_LABEL mcuboot_secondary
#define FIXED_CHUNK_SIZE 273



LOG_MODULE_DECLARE(lte_ble_gw);
#define MAX_BINARY_CHUNK_SIZE  247

//static update_start_cb update_start;
//static char filename[128] = {0};

//static struct flash_img_context ctx;

//static bool ctx_initialized = false;
//static const struct flash_area *flash_area;

//initializing all values to zero. 
atomic_t current9160Chunk = ATOMIC_INIT(0);
atomic_t currentRPiChunk = ATOMIC_INIT(0);
atomic_t currentESP32Chunk = ATOMIC_INIT(0);
int total9160Chunks = 0;
int totalRPiChunks = 0;
int totalESP32Chunks = 0;
bool update9160Flag = false;
bool updateRPiFlag = 0;
bool updateESP32Flag = false;


//Takes decoded binary data and processes it.



int finalize_firmware_update(void) {
    int err;

    // Inform MCUboot that the update is complete
    err = boot_request_upgrade(BOOT_UPGRADE_TEST);
    if (err != 0) {
        LOG_ERR("Failed to mark update as complete: %d", err);
        // Handle error (e.g., retry, log, notify server)
        return -1;
    }

    LOG_INF("Firmware update marked as complete. Rebooting...");

    // Trigger a system reboot
    sys_reboot(SYS_REBOOT_COLD);
    //this is never reached. 
    return 0;
}

static int write_firmware_chunk_to_flash(uint32_t chunkId, const uint8_t *data, size_t len) {
    const struct flash_area *secondary_area;
    int err;
    size_t offset;

    // Open the secondary slot partition
    err = flash_area_open(FLASH_AREA_ID(SECONDARY_PARTITION_LABEL), &secondary_area);
    if (err != 0) {
        printk("Error opening secondary slot flash area: %d\n", err);
        return err;
    }

    // Calculate the offset for this chunk
    // For example, if each chunk is of fixed size, this could be:
    offset = chunkId * FIXED_CHUNK_SIZE;

    // Ensure offset + len does not exceed the partition size
    if (offset + len > secondary_area->fa_size) {
        printk("Chunk write exceeds partition size\n");
        flash_area_close(secondary_area);
        return -EINVAL;
    }

    // Write the chunk to the flash
    err = flash_area_write(secondary_area, offset, data, len);
    if (err != 0) {
        printk("Error writing to flash: %d\n", err);
    }

    // Close the flash area
    flash_area_close(secondary_area);

    return err;
}

int process_firmware_chunk(int chunk_id, const char *decoded_data, size_t decoded_len) {
    int err;
    uint32_t currentChunk;

    // Write the decoded chunk to the appropriate flash location
    err = write_firmware_chunk_to_flash(chunk_id, (const uint8_t *)decoded_data, decoded_len);
    if (err != 0) {
        printk("Error writing firmware chunk to flash: %d\n", err);
        // Handle the error (e.g., abort the update, retry, log error, etc.)
        return err;
    }

    // Read the current chunk value from the atomic variable
    currentChunk = atomic_get(&current9160Chunk);

    // Check if this is the last chunk
    if (currentChunk == total9160Chunks) {
        printk("Firmware update complete. Finalizing update...\n");
        err = finalize_firmware_update();
        if (err != 0) {
            printk("Error finalizing firmware update: %d\n", err);
            return err;
        }
    }

    return 0; // Success
}






int OTAInit(void)
{
	LOG_INF("OTA update Inititalizing...");
	//Initialize all values for firmware updates to zero.

	//This is needed so that MCUBoot won't revert the update
	boot_write_img_confirmed();

    return 0;
}
```

## src/update.h
```c
/*
 * Copyright (c) 2020 Nordic Semiconductor ASA
 *
 * SPDX-License-Identifier: LicenseRef-Nordic-5-Clause
 */

#ifndef UPDATE_H__
#define UPDATE_H__

#define TLS_SEC_TAG 42
#include <zephyr/sys/atomic.h>     // For atomic_t
#ifndef CONFIG_USE_HTTPS
#define SEC_TAG (-1)
#else
#define SEC_TAG (TLS_SEC_TAG)
#endif



extern atomic_t  current9160Chunk;
extern int total9160Chunks;
extern bool update9160Flag;

extern atomic_t  currentRPiChunk;
extern int totalRPiChunks;
extern bool updateRPiFlag;

extern atomic_t  currentESP32Chunk;
extern int totalESP32Chunks;
extern bool updateESP32Flag;


int process_firmware_chunk(int chunk_id, const char *decoded_data, size_t decoded_len);

int OTAInit(void);


#endif /* UPDATE_H__ */
```
