## prj.conf
```kconfig
#
# Copyright (c) 2020 Nordic Semiconductor ASA
# Copyright (c) 2019 Nordic Semiconductor ASA
#
# SPDX-License-Identifier: LicenseRef-Nordic-5-Clause
#

# General config
CONFIG_NEWLIB_LIBC=y
CONFIG_NEWLIB_LIBC_FLOAT_PRINTF=y
CONFIG_ASSERT=y
CONFIG_REBOOT=y

# Logging
CONFIG_LOG=y
CONFIG_LTE_BLE_GW_LOG_LEVEL_INF=y
# CONFIG_BT_DEBUG_LOG=y

# Button and LED support
CONFIG_DK_LIBRARY=y

# Networking
CONFIG_NETWORKING=y
CONFIG_NET_NATIVE=n
CONFIG_NET_SOCKETS_OFFLOAD=y
CONFIG_NET_SOCKETS=y
CONFIG_NET_SOCKETS_POSIX_NAMES=y

# Memory
CONFIG_MAIN_STACK_SIZE=8192
CONFIG_HEAP_MEM_POOL_SIZE=24576 
CONFIG_SYSTEM_WORKQUEUE_STACK_SIZE=4096
CONFIG_BT_L2CAP_TX_MTU=100
CONFIG_BT_BUF_ACL_RX_SIZE=275
CONFIG_BT_BUF_ACL_RX_COUNT=6
CONFIG_BT_BUF_ACL_TX_COUNT=6




# Modem library
CONFIG_NRF_MODEM_LIB=y
CONFIG_NRF_MODEM_LIB_SYS_INIT=n
CONFIG_NRF_MODEM_LIB_ON_FAULT_APPLICATION_SPECIFIC=y
CONFIG_NRF_MODEM_LIB_TRACE=n

# LTE link control
CONFIG_LTE_LINK_CONTROL=y
CONFIG_LTE_NETWORK_MODE_LTE_M_GPS=y
CONFIG_LTE_AUTO_INIT_AND_CONNECT=n

# AT host
CONFIG_AT_HOST_LIBRARY=y

# Modem info
CONFIG_MODEM_INFO=y
CONFIG_MODEM_INFO_ADD_NETWORK=y


# Console
CONFIG_CONSOLE_SUBSYS=y
CONFIG_CONSOLE_GETCHAR=y

# Enable the BLE stack with GATT Client configuration
CONFIG_BT=y
CONFIG_BT_CENTRAL=y
CONFIG_BT_SMP=y
CONFIG_BT_SETTINGS=y
CONFIG_BT_GATT_CLIENT=y

# Enable the BLE modules from NCS
CONFIG_BT_NUS_CLIENT=y
CONFIG_BT_SCAN=y
CONFIG_BT_SCAN_FILTER_ENABLE=y
CONFIG_BT_SCAN_UUID_CNT=1
CONFIG_BT_GATT_DM=y





# Enable bonding

CONFIG_FLASH=y
CONFIG_FLASH_PAGE_LAYOUT=y
CONFIG_FLASH_MAP=y
CONFIG_NVS=y
CONFIG_SETTINGS=y

CONFIG_UART_INTERRUPT_DRIVEN=y

# MQTT
CONFIG_MQTT_LIB=y
CONFIG_MQTT_CLEAN_SESSION=y
CONFIG_MQTT_PUB_TOPIC="/oneM2M/req/NRFParent:NRF9160/capstone-iot/json"
CONFIG_MQTT_SUB_TOPIC="/oneM2M/resp/NRFParent:NRF9160/capstone-iot/json"
CONFIG_BUTTON_EVENT_PUBLISH_MSG="{\"op\":2,\"to\":\"cse-in/NRFParent\",\"fr\":\"CNRFParent\",\"rqi\":\"123\",\"rvi\":\"3\",\"fu\":6,\"ty\":4,\"rcn\":4}"
CONFIG_MQTT_BROKER_HOSTNAME="52.14.47.13"
CONFIG_MQTT_BROKER_PORT=1883
```

## src/main.c
```c
/*
 * Copyright (c) 2018 Nordic Semiconductor ASA
 *
 * SPDX-License-Identifier: LicenseRef-Nordic-5-Clause
 */

#include <zephyr/kernel.h>
#include <stdio.h>
#include <zephyr/net/socket.h>


#include <string.h>
#include <nrf_modem_at.h>
#include <nrf_modem_gnss.h>
#include <zephyr/console/console.h>
#include <dk_buttons_and_leds.h>
#include <modem/lte_lc.h>
#include <zephyr/sys/reboot.h>
#include <modem/nrf_modem_lib.h>
#include <zephyr/logging/log.h>
#include <zephyr/net/mqtt.h>


#include "mqtt_connection.h"
#include "ble.h"
#include "mqtt_ble_pipe.h"


static K_SEM_DEFINE(lte_connected, 0, 1);
/* The mqtt client struct */
struct mqtt_client client;
/* File descriptor */
struct pollfd fds;

LOG_MODULE_REGISTER(lte_ble_gw, CONFIG_LTE_BLE_GW_LOG_LEVEL);

/* Interval in milliseconds between each time status LEDs are updated. */
#define LEDS_UPDATE_INTERVAL K_MSEC(500)

/* Interval in microseconds between each time LEDs are updated when indicating
 * that an error has occurred.
 */
#define LEDS_ERROR_UPDATE_INTERVAL 250000

#define BUTTON_1 BIT(0)
#define BUTTON_2 BIT(1)
#define SWITCH_1 BIT(2)
#define SWITCH_2 BIT(3)

#define LED_ON(x)			(x)
#define LED_BLINK(x)		((x) << 8)
#define LED_GET_ON(x)		((x) & 0xFF)
#define LED_GET_BLINK(x)	(((x) >> 8) & 0xFF)

/* Interval in milliseconds after the device will retry cloud connection
 * if the event NRF_CLOUD_EVT_TRANSPORT_CONNECTED is not received.
 */
#define RETRY_CONNECT_WAIT K_MSEC(90000)

//To do: Update LEDs.
enum {
	LEDS_INITIALIZING       = LED_ON(0),
	LEDS_LTE_CONNECTING     = LED_BLINK(DK_LED3_MSK),
	LEDS_LTE_CONNECTED      = LED_ON(DK_LED3_MSK),
	LEDS_CLOUD_CONNECTING   = LED_BLINK(DK_LED4_MSK),
	LEDS_CLOUD_PAIRING_WAIT = LED_BLINK(DK_LED3_MSK | DK_LED4_MSK),
	LEDS_CLOUD_CONNECTED    = LED_ON(DK_LED4_MSK),
	LEDS_ERROR              = LED_ON(DK_ALL_LEDS_MSK)
} display_state;




/* Structures for work */
struct k_work_delayable leds_update_work;
struct k_work_delayable periodic_transmit_work;
struct k_work_delayable periodic_publish_work;




enum error_type {
	ERROR_NRF_CLOUD,
	ERROR_MODEM_RECOVERABLE,
};

/* Forward declaration of functions. */
static void work_init(void);

static void lte_handler(const struct lte_lc_evt *const evt)
{
     switch (evt->type) {
     case LTE_LC_EVT_NW_REG_STATUS:
        if ((evt->nw_reg_status != LTE_LC_NW_REG_REGISTERED_HOME) &&
            (evt->nw_reg_status != LTE_LC_NW_REG_REGISTERED_ROAMING)) {
            break;
        }
		LOG_INF("Network registration status: %s",
				evt->nw_reg_status == LTE_LC_NW_REG_REGISTERED_HOME ?
				"Connected - home network" : "Connected - roaming");
		k_sem_give(&lte_connected);
        break;
	case LTE_LC_EVT_RRC_UPDATE:
		LOG_INF("RRC mode: %s", evt->rrc_mode == LTE_LC_RRC_MODE_CONNECTED ?
				"Connected" : "Idle");
		break;
     default:
             break;
     }
}


/**@brief nRF Cloud error handler. */
void error_handler(enum error_type err_type, int err)
{
	if (err_type == ERROR_NRF_CLOUD) {
		int err;

		/* Turn off and shutdown modem */
		k_sched_lock();
		err = lte_lc_power_off();
		__ASSERT(err == 0, "lte_lc_power_off failed: %d", err);
		nrf_modem_lib_shutdown();
	}

#if !defined(CONFIG_DEBUG)
	sys_reboot(SYS_REBOOT_COLD);
#else
	uint8_t led_pattern;

	switch (err_type) {
	case ERROR_NRF_CLOUD:
		/* Blinking all LEDs ON/OFF in pairs (1 and 4, 2 and 3)
		 * f there is an application error.
		 */
		led_pattern = DK_LED1_MSK | DK_LED4_MSK;
		LOG_ERR("Error of type ERROR_NRF_CLOUD: %d", err);
		break;
	case ERROR_MODEM_RECOVERABLE:
		/* Blinking all LEDs ON/OFF in pairs (1 and 3, 2 and 4)
		 * if there is a recoverable error.
		 */
		led_pattern = DK_LED1_MSK | DK_LED3_MSK;
		LOG_ERR("Error of type ERROR_MODEM_RECOVERABLE: %d", err);
		break;
	default:
		/* Blinking all LEDs ON/OFF in pairs (1 and 2, 3 and 4)
		 * undefined error.
		 */
		led_pattern = DK_LED1_MSK | DK_LED2_MSK;
		break;
	}

	while (true) {
		dk_set_leds(led_pattern & 0x0f);
		k_busy_wait(LEDS_ERROR_UPDATE_INTERVAL);
		dk_set_leds(~led_pattern & 0x0f);
		k_busy_wait(LEDS_ERROR_UPDATE_INTERVAL);
	}
#endif /* CONFIG_DEBUG */
}

/**@brief Modem fault handler. */
void nrf_modem_fault_handler(struct nrf_modem_fault_info *fault_info)
{
	error_handler(ERROR_MODEM_RECOVERABLE, (int)fault_info->reason);
}

/**@brief Update LEDs state. */
static void leds_update(struct k_work *work)
{
	static bool led_on;
	static uint8_t current_led_on_mask;
	uint8_t led_on_mask = current_led_on_mask;

	ARG_UNUSED(work);

	/* Reset LED3 and LED4. */
	led_on_mask &= ~(DK_LED3_MSK | DK_LED4_MSK);

	/* Set LED3 and LED4 to match current state. */
	led_on_mask |= LED_GET_ON(display_state);

	led_on = !led_on;
	if (led_on) {
		led_on_mask |= LED_GET_BLINK(display_state);
	} else {
		led_on_mask &= ~LED_GET_BLINK(display_state);
	}

	if (led_on_mask != current_led_on_mask) {
		dk_set_leds(led_on_mask);
		current_led_on_mask = led_on_mask;
	}

	k_work_schedule(&leds_update_work, LEDS_UPDATE_INTERVAL);
}


/**@brief Callback for button events from the DK buttons and LEDs library. */
static void button_handler(uint32_t buttons, uint32_t has_changed)
{
	switch (has_changed) {
	case DK_BTN1_MSK:
		/* STEP 7.2 - When button 1 is pressed, call data_publish() to publish a message */
		if (buttons & DK_BTN1_MSK){
			int err = data_publish(&client, MQTT_QOS_1_AT_LEAST_ONCE,
				   CONFIG_BUTTON_EVENT_PUBLISH_MSG, sizeof(CONFIG_BUTTON_EVENT_PUBLISH_MSG)-1);
			if (err) {
				LOG_INF("Failed to send message, %d", err);
				return;
			}
		}
		break;
	}
}

/**@brief Initializes and submits delayed work. */
static void work_init(void)
{
	k_work_init_delayable(&leds_update_work, leds_update);
	k_work_schedule(&leds_update_work, LEDS_UPDATE_INTERVAL);
	k_work_init_delayable(&periodic_transmit_work, transmit_aggregated_data);
	k_work_schedule(&periodic_transmit_work, K_MSEC(10000));
	k_work_init_delayable(&periodic_publish_work, publish_aggregated_data);
	k_work_schedule(&periodic_publish_work, K_MSEC(10000));
}

/**@brief Configures modem to provide LTE link. Blocks until link is
 * successfully established.
 */

static int modem_configure(void)
{
	int err;

	LOG_INF("Initializing modem library");

	err = nrf_modem_lib_init();
	if (err) {
		LOG_ERR("Failed to initialize the modem library, error: %d", err);
		return err;
	}

	LOG_INF("Connecting to LTE network");

	err = lte_lc_init_and_connect_async(lte_handler);
	if (err) {
		LOG_INF("Modem could not be configured, error: %d", err);
		return err;
	}

	k_sem_take(&lte_connected, K_FOREVER);
	LOG_INF("Connected to LTE network");
	display_state = LEDS_LTE_CONNECTED;

	return 0;
}

int main(void)
{
	int err;
	uint32_t connect_attempt = 0;
	LOG_INF("LTE Sensor Gateway sample started");

	
	
	

	if (dk_leds_init() != 0) {
		LOG_ERR("Failed to initialize the LED library");
	}

	err = modem_configure();
	if (err) {
		LOG_ERR("Failed to configure the modem");
		return 0;
	}

	if (dk_buttons_init(button_handler) != 0) {
		LOG_ERR("Failed to initialize the buttons library");
	}

	err = client_init(&client);
	if (err) {
		LOG_ERR("Failed to initialize MQTT client: %d", err);
		return 0;
	}
	work_init();		//Currently just using it to blink some LEDs.
	err = ble_init();		    //Initializes bluetooth (ble.c)
	if (err) {
		LOG_ERR("Failed to initialize BLE: %d", err);
		return 0;
	}
do_connect:
	if (connect_attempt++ > 0) {
		LOG_INF("Reconnecting in %d seconds...",
			CONFIG_MQTT_RECONNECT_DELAY_S);
		k_sleep(K_SECONDS(CONFIG_MQTT_RECONNECT_DELAY_S));
	}
	err = mqtt_connect(&client);
	if (err) {
		LOG_ERR("Error in mqtt_connect: %d", err);
		goto do_connect;
	}

	err = fds_init(&client,&fds);
	if (err) {
		LOG_ERR("Error in fds_init: %d", err);
		return 0;
	}

	while (1) {
		err = poll(&fds, 1, mqtt_keepalive_time_left(&client));
		if (err < 0) {
			LOG_ERR("Error in poll(): %d", errno);
			break;
		}

		err = mqtt_live(&client);
		if ((err != 0) && (err != -EAGAIN)) {
			LOG_ERR("Error in mqtt_live: %d", err);
			break;
		}

		if ((fds.revents & POLLIN) == POLLIN) {
			err = mqtt_input(&client);
			if (err != 0) {
				LOG_ERR("Error in mqtt_input: %d", err);
				break;
			}
		}

		if ((fds.revents & POLLERR) == POLLERR) {
			LOG_ERR("POLLERR");
			break;
		}

		if ((fds.revents & POLLNVAL) == POLLNVAL) {
			LOG_ERR("POLLNVAL");
			break;
		}
	}

	LOG_INF("Disconnecting MQTT client");

	err = mqtt_disconnect(&client);
	if (err) {
		LOG_ERR("Could not disconnect MQTT client: %d", err);
	}
	goto do_connect;
	LOG_ERR("How'd we get here?");
	/* This is never reached */
	return 0;
}
```

## src/aggregator.c
```c
/*
 * Copyright (c) 2018 Nordic Semiconductor ASA
 *
 * SPDX-License-Identifier: LicenseRef-Nordic-5-Clause
 */

#include <zephyr/kernel.h>
#include <zephyr/kernel.h>
#include <stdio.h>
#include <zephyr/types.h>
#include <string.h>
#include <zephyr/irq.h>
#include <zephyr/logging/log.h>

#include "aggregator.h"

LOG_MODULE_DECLARE(lte_ble_gw);

#define SERIALIZED_DATA_MAX_SIZE 300 // Some number. Probably wrong. To-Do: Update.
K_FIFO_DEFINE(uplink_aggregator_fifo);
K_FIFO_DEFINE(downlink_aggregator_fifo);

static uint32_t uplink_entry_count;

static uint32_t downlink_entry_count;

struct uplink_fifo_entry {
	void *fifo_reserved;
	uint8_t data[sizeof(struct uplink_data_packet)];
};

struct downlink_fifo_entry {
	void *fifo_reserved;
	uint8_t data[sizeof(struct downlink_data_packet)];
};

//newstruct for firmware:
struct fdownlink_fifo_entry {
	void *fifo_reserved;
	uint8_t data[sizeof(struct downlink_data_packet)];
};

int uplink_aggregator_put(struct uplink_data_packet in_data)
{
	struct uplink_fifo_entry *fifo_data = NULL;
	uint32_t  lock = irq_lock();
	int    err  = 0;

	if (uplink_entry_count == FIFO_MAX_ELEMENT_COUNT) {
		fifo_data = k_fifo_get(&uplink_aggregator_fifo, K_NO_WAIT);

		__ASSERT(fifo_data != NULL, "fifo_data should not be NULL");

		uplink_entry_count--;
	}

	if (fifo_data == NULL) {
		fifo_data = k_malloc(sizeof(in_data));
	}

	if (fifo_data == NULL) {
		err = -ENOMEM;
		goto exit;
	}

	memcpy(fifo_data->data, &in_data, sizeof(in_data));

	k_fifo_put(&uplink_aggregator_fifo, fifo_data);
	uplink_entry_count++;

exit:
	irq_unlock(lock);
	return err;
}

int uplink_aggregator_get(struct uplink_data_packet *out_data)
{
	void  *fifo_data;
	int   err = 0;

	if (out_data == NULL) {
		return -EINVAL;
	}

	uint32_t lock = 0;
	lock = irq_lock();

	fifo_data = k_fifo_get(&uplink_aggregator_fifo, K_NO_WAIT);
	if (fifo_data == NULL) {
		err = -ENODATA;
		goto exit;
	}

	memcpy(out_data, ((struct uplink_fifo_entry *)fifo_data)->data,
	       sizeof(struct uplink_data_packet));

	k_free(fifo_data);
	uplink_entry_count--;

exit:
	irq_unlock(lock);
	return err;
}




int downlink_aggregator_get(struct downlink_data_packet *out_data)
{
	//LOG_INF ("downlink_aggregator_get called"); //Super spammy.
	void  *fifo_data;
	int   err = 0;
	
	if (out_data == NULL) {
		//LOG_INF ("OutData is NULL");
		return -EINVAL;
	}


	fifo_data = k_fifo_get(&downlink_aggregator_fifo, K_NO_WAIT);
	if (fifo_data == NULL) {
		err = -ENODATA;
		//LOG_INF ("FIFO is Empty"); //Super spammy.
		goto exit;
	}


	uint32_t lock = irq_lock();


	memcpy(out_data, ((struct downlink_fifo_entry *)fifo_data)->data,
	       sizeof(struct downlink_data_packet));
	LOG_INF ("downlink_aggregator_get: %s", out_data->data);
	k_free(fifo_data);
	downlink_entry_count--;

exit:
	irq_unlock(lock);
	return err;
}

int downlink_aggregator_put(struct downlink_data_packet in_data)
{
	struct downlink_fifo_entry *fifo_data = NULL;
	uint32_t  lock = irq_lock();
	int	err  = 0;
	LOG_INF ("downlink_aggregator_put called");
	if (downlink_entry_count == FIFO_MAX_ELEMENT_COUNT) {
		fifo_data = k_fifo_get(&downlink_aggregator_fifo, K_NO_WAIT);

		__ASSERT(fifo_data != NULL, "fifo_data should not be NULL");

		downlink_entry_count--;
	}

	if (fifo_data == NULL) {
		fifo_data = k_malloc(sizeof(struct downlink_fifo_entry));
	}

	if (fifo_data == NULL) {
		err = -ENOMEM;
		goto exit;
	}
	
	memcpy(fifo_data->data, &in_data, sizeof(struct downlink_data_packet));
	LOG_INF("downlink_aggregator_put: %s", in_data.data);
	k_fifo_put(&downlink_aggregator_fifo, fifo_data);
	downlink_entry_count++;

exit:
	irq_unlock(lock);
	return err;
}
/*
//new downlink put function for new struct:
int fdownlink_aggregator_get(struct firmware_update_packet_t *out_data)
{
	//LOG_INF ("downlink_aggregator_get called"); //Super spammy.
	void  *fifo_data;
	int   err = 0;
	
	if (out_data == NULL) {
		//LOG_INF ("OutData is NULL");
		return -EINVAL;
	}


	fifo_data = k_fifo_get(&downlink_aggregator_fifo, K_NO_WAIT);
	if (fifo_data == NULL) {
		err = -ENODATA;
		//LOG_INF ("FIFO is Empty"); //Super spammy.
		goto exit;
	}


	uint32_t lock = irq_lock();


	memcpy(out_data, ((struct fdownlink_fifo_entry *)fifo_data)->data,
	       sizeof(struct downlink_data_packet));
	LOG_INF ("downlink_aggregator_get: %s", out_data->data);
	k_free(fifo_data);
	downlink_entry_count--;

exit:
	irq_unlock(lock);
	return err;
}

int fdownlink_aggregator_put(struct downlink_data_packet in_data)
{
	struct downlink_fifo_entry *fifo_data = NULL;
	uint32_t  lock = irq_lock();
	int	err  = 0;
	LOG_INF ("downlink_aggregator_put called");
	if (downlink_entry_count == FIFO_MAX_ELEMENT_COUNT) {
		fifo_data = k_fifo_get(&downlink_aggregator_fifo, K_NO_WAIT);

		__ASSERT(fifo_data != NULL, "fifo_data should not be NULL");

		downlink_entry_count--;
	}

	if (fifo_data == NULL) {
		fifo_data = k_malloc(sizeof(struct fdownlink_fifo_entry));
	}

	if (fifo_data == NULL) {
		err = -ENOMEM;
		goto exit;
	}
	
	memcpy(fifo_data->data, &in_data, sizeof(struct downlink_data_packet));
	LOG_INF("downlink_aggregator_put: %s", in_data.data);
	k_fifo_put(&downlink_aggregator_fifo, fifo_data);
	downlink_entry_count++;

exit:
	irq_unlock(lock);
	return err;
}
*/

void aggregator_clear(void)
{
	void *fifo_data;
	uint32_t lock = 0;
	lock = irq_lock();

	while (1) {
		fifo_data = k_fifo_get(&uplink_aggregator_fifo, K_NO_WAIT);

		if (fifo_data == NULL) {
			break;
		}

		k_free(fifo_data);
	};

	uplink_entry_count = 0;

	while (1) {
		fifo_data = k_fifo_get(&downlink_aggregator_fifo, K_NO_WAIT);

		if (fifo_data == NULL) {
			break;
		}

		k_free(fifo_data);
	};
	downlink_entry_count = 0;
	irq_unlock(lock);
}
```

## src/aggregator.h
```c
/*
 * Copyright (c) 2018 Nordic Semiconductor ASA
 *
 * SPDX-License-Identifier: LicenseRef-Nordic-5-Clause
 */

#ifndef _AGGREGATOR_H_
#define _AGGREGATOR_H_
#include <stdint.h>


/*
 * Simple aggregator module which can have sensordata added and retrieved in a
 * FIFO fashion. The queue allows TLD formated data to be aggregated from
 * sensors in a FIFO fashion. When some event in the future causes data
 * transfer to start, the most recent X datapoints (determined by ENTRY_MAX_SIZE
 * and HEAP_MEM_POOL_SIZE) can be transferred.
 *
 * Note: The module is single instance to allow simple global access to the
 * data.
 * 
 * This is edited from the original sample program.
 */


#define ENTRY_MAX_SIZE (100)				//This is probably wrong. Will have to change later.
#define FIFO_MAX_ELEMENT_COUNT 12

enum uplink_data_packet_type {						//Data types for going up are text and image.
	uplink_TEXT,
    IMAGE_DATA,
};
enum ble_source {
	SOURCE_ESP32,
	SOURCE_RaspberryPi,
};

struct uplink_data_packet {						//This is the data structure that will be used to store data going upwards to MQTT.
	uint8_t length;
	enum uplink_data_packet_type type;
	enum ble_source source;
	uint8_t data[ENTRY_MAX_SIZE];
};

enum downlink_data_packet_type {					//Data types for going down are firmware update and image.
	downlink_TEXT,
	FIRMWARE_UPDATE,
};
enum ble_destination {					//Destination for data going down is either ESP32 or Raspberry Pi.
	DESTINATION_ESP32,					
	DESTINATION_RaspberryPi,
	DESTINATION_UNKNOWN,
};

struct downlink_data_packet {				//This is the data structure that is used to store data going downwards to BLE.
	uint8_t length;
	enum downlink_data_packet_type type;
	enum ble_destination destination;
	uint8_t data[ENTRY_MAX_SIZE];
	
	char version[8];            // Assuming max version string length is 7 (e.g., "1.0.2") + null terminator
    uint32_t chunk;             // Suitable for a large number of chunks
    uint32_t total_chunks;      // Same as above
    size_t data_length;         // To keep track of the actual length of decoded data
    char checksum[65]; 
};
/*
// new struct for firmware update downlink
struct firmware_update_packet_t{
    char version[8];            // Assuming max version string length is 7 (e.g., "1.0.2") + null terminator
    enum ble_destination destination;       // "esp32" can fit easily within this, with some room to spare
    uint32_t chunk;             // Suitable for a large number of chunks
    uint32_t total_chunks;      // Same as above
    uint8_t data[ENTRY_MAX_SIZE];         // Adjust this size based on your expected max data length after decoding from Base64
    size_t data_length;         // To keep track of the actual length of decoded data
    char checksum[65];          // SHA-256 results in a 64-character hexadecimal number + null terminator
};
*/




int aggregator_init(void);

int uplink_aggregator_put(struct uplink_data_packet data);

int uplink_aggregator_get(struct uplink_data_packet *data);

int downlink_aggregator_put(struct downlink_data_packet data);

int downlink_aggregator_get(struct downlink_data_packet *data);

void aggregator_clear(void);

int aggregator_element_count_get(void);
/*
// new function for firmware update downlink
int fdownlink_aggregator_put(struct firmware_update_packet_t data);

int fdownlink_aggregator_get(struct firmware_update_packet_t *data);
*/
#endif /* _AGGREGATOR_H_ */
```

## src/ble.c
```c
/*
 * Copyright (c) 2018 Nordic Semiconductor ASA
 *
 * SPDX-License-Identifier: LicenseRef-Nordic-5-Clause
 */

#include <zephyr/kernel.h>

#include <zephyr/bluetooth/bluetooth.h>
#include <zephyr/bluetooth/gatt.h>
#include <zephyr/bluetooth/uuid.h>
#include <zephyr/bluetooth/conn.h>
#include <zephyr/bluetooth/hci.h>

#include <bluetooth/gatt_dm.h>
#include <bluetooth/scan.h>
#include <bluetooth/conn_ctx.h>
#include <bluetooth/services/nus.h>
#include <bluetooth/services/nus_client.h>

#include <zephyr/settings/settings.h>
#include <dk_buttons_and_leds.h>
#include <zephyr/sys/byteorder.h>

#include <errno.h>
#include <stdio.h>
#include <zephyr/logging/log.h>
#include "aggregator.h"
#include "ble.h"

static struct bt_conn *default_conn;
static struct bt_nus_client default_nus_client;

K_SEM_DEFINE(nus_write_sem, 0, 1);


LOG_MODULE_DECLARE(lte_ble_gw);
//#define BT_UUID_NUS_SERVICE BT_UUID_DECLARE_128(BT_UUID_128_ENCODE(0x00000001, 0x710e, 0x4a5b, 0x8d75, 0x3e5b444bc3cf))
#define BT_UUID_NUS_SERVICE BT_UUID_DECLARE_128(BT_UUID_128_ENCODE(0x6E400001, 0xB5A3, 0xF393, 0xE0A9, 0xE50E24DCCA9E))
/*
#define BT_UUID_ESP32_RX_VAL \
    BT_UUID_128_ENCODE(0x6E400002, 0xB5A3, 0xF393, 0xE0A9, 0xE50E24DCCA9E)
#define BT_UUID_ESP32_RX \
    BT_UUID_DECLARE_128(BT_UUID_ESP32_RX_VAL)

#define BT_UUID_ESP32_TX_VAL \
    BT_UUID_128_ENCODE(0x6E400003, 0xB5A3, 0xF393, 0xE0A9, 0xE50E24DCCA9E)
#define BT_UUID_ESP32_TX \
    BT_UUID_DECLARE_128(BT_UUID_ESP32_TX_VAL)
*/
/*
#define BT_UUID_rPI_SERVICE_VAL \
    BT_UUID_128_ENCODE(0x00000001, 0x710e, 0x4a5b, 0x8d75, 0x3e5b444bc3cf)
#define BT_UUID_rPI_SERVICE \
    BT_UUID_DECLARE_128(BT_UUID_rPI__SERVICE_VAL)

#define BT_UUID_rPI_RX_VAL \
    BT_UUID_128_ENCODE(0x00000002, 0x710e, 0x4a5b, 0x8d75, 0x3e5b444bc3cf)
#define BT_UUID_rPI_RX \
    BT_UUID_DECLARE_128(BT_UUID_rPI__RX_VAL)

#define BT_UUID_rPI_TX_VAL \
    BT_UUID_128_ENCODE(0x00000003, 0x710e, 0x4a5b, 0x8d75, 0x3e5b444bc3cf)
#define BT_UUID_rPI_TX \
    BT_UUID_DECLARE_128(BT_UUID_rPI__TX_VAL)
*/

#define MAX_CONNECTED_DEVICES 5

#define BT_NAME_MAX_LEN 248	//super overkill but this is the default, I suppose?
/*
struct ble_device {   // device connected struct.
    struct bt_conn *conn;
    enum ble_destination destination;       // device name: i.e. Rasperry Pi, ESP32, etc.
    struct bt_nus_client *nus_client;        // NUS client instance for the device
};
*/

//static struct ble_device devices_list[MAX_CONNECTED_DEVICES];

struct bt_conn* get_conn_from_destination(enum ble_destination destination) {
    /*
    for (int i = 0; i < MAX_CONNECTED_DEVICES; i++) {
        if (devices_list[i].destination == destination) {
            return devices_list[i].conn;
        }
    }
    return NULL; // No connection found for the given destination
    */
    return default_conn;
}
/*
enum ble_destination get_destination_from_conn(struct bt_conn *conn) {
    for (int i = 0; i < MAX_CONNECTED_DEVICES; i++) {
		if (devices_list[i].conn == conn) {
			return devices_list[i].destination;
		}
	}
	return DESTINATION_UNKNOWN; // No destination found for the given connection
}
*/
//Function prototyping for the device name function.
char *get_device_name(struct bt_conn *conn);

/*
static void setup_connection(struct bt_conn *conn, struct bt_nus_client *nus) {
    for (int i = 0; i < MAX_CONNECTED_DEVICES; i++) {
        if (!devices_list[i].conn) {
            devices_list[i].conn = conn;
            devices_list[i].destination = DESTINATION_UNKNOWN;
			devices_list[i].nus_client = nus;

            LOG_INF("Connection in array initialized.");
            break;
        }
    }
}
*/
/*
static void remove_connection(struct bt_conn *conn) {
    for (int i = 0; i < MAX_CONNECTED_DEVICES; i++) {
        if (devices_list[i].conn == conn) {
            devices_list[i].conn = NULL;
            devices_list[i].destination = DESTINATION_UNKNOWN; // Set to an "unknown" or "unset" value
            break;
        }
    }
}
*/
// seperate data in ChunkData struct;
/*
void ble_send_packet(const char* buffer, int size){
     if (buffer == NULL || size == 0) {
        LOG_ERR("Invalid arguments"); // Error: Invalid arguments
    }
    int totalchunk = size/CHUNK_SIZE;
    
    struct ChunkData* data_chunks = (struct ChunkData*)malloc(totalchunk * CHUNK_SIZE);
    // Copy data into chunks
    int index= 0;
    for(int i = 0; i < totalchunk; i++){
        data_chunks[i].current_chunk = i;
        // data_chunks[i].total_chunks = totalchunk;
        memcpy(data_chunks[i].data, buffer + i*CHUNK_SIZE, CHUNK_SIZE - sizeof(data_chunks[i]));
        index+=(CHUNK_SIZE-sizeof(data_chunks[i]));
        //sending data_chunks[i]   uncomplete

    }
}
*/
static void ble_data_sent(struct bt_nus_client *nus, uint8_t err,
					const uint8_t *const data, uint16_t len)
{
	LOG_INF("Data sent via NUS");
	ARG_UNUSED(nus);

	//free buffer after send?

	k_sem_give(&nus_write_sem);

	if (err) {
		LOG_WRN("ATT error code: 0x%02X", err);
	}

	
}


int ble_transmit(struct bt_conn *conn, uint8_t *data, size_t length) {
    LOG_INF("Transmit called...");

    if (!data || !length) {
        return -EINVAL;
    }
    if (!conn) {
        LOG_INF("No connection found for destination");
        return -EINVAL;
    }
    /*
    struct ble_device *device = NULL;
    for (int i = 0; i < MAX_CONNECTED_DEVICES; i++) {
        if (devices_list[i].conn == conn) {
            device = &devices_list[i];
            break;
        }
    }

    if (!device) {
        LOG_ERR("Device not found for connection");
        return -ENODEV;
    }


    struct bt_nus_client *nus_client = device->nus_client;
    */
    int err = bt_nus_client_send(&default_nus_client, data, length);
    if (err) {
        LOG_ERR("Failed to send data over BLE using NUS: %d", err);
        return err;
    }

    return 0;
}
static void discovery_completed(struct bt_gatt_dm *dm, void *context)
{
    struct bt_nus_client *nus = context;
    LOG_INF("Service discovery completed");
    bt_gatt_dm_data_print(dm);

	bt_nus_handles_assign(dm, nus);
	bt_nus_subscribe_receive(nus);

	


    /*
	struct bt_conn *conn = bt_gatt_dm_conn_get(dm);
	struct bt_nus_client *nus = (struct bt_nus_client *)context;
	//setup_connection(conn, nus);  // Add the connection to the list and initialize the NUS client for this connection
    LOG_INF("Service discovery completed");

    // Print discovered attributes (for debugging)
    bt_gatt_dm_data_print(dm);

    // Assign handles using the NUS client library function
    if (bt_nus_handles_assign(dm, nus) < 0) {
        LOG_ERR("Failed to assign handles");
        goto release;
    }

    // Subscribe to the RX characteristic using the NUS client library function
    if (bt_nus_subscribe_receive(nus) < 0) {
        LOG_ERR("Failed to subscribe to RX characteristic");
        goto release;
    }

    
    for (int i = 0; i < MAX_CONNECTED_DEVICES; i++) {
        if (devices_list[i].conn == conn) {

            char *device_name = get_device_name(conn);
            if (device_name) {
                // Now you can use the device_name to determine the device type
                if (strncmp(device_name, "ESP32", 6) == 0) {
                    LOG_INF("Device is ESP32");
                    devices_list[i].destination = DESTINATION_ESP32;
                } else if (strncmp(device_name, "RaspberryPi-", 12) == 0) {
                    LOG_INF("Device is Raspberry Pi");
                    devices_list[i].destination = DESTINATION_RaspberryPi;
                } else {
                    LOG_INF("Device is Unknown. Setting it to ESP32 for now.");
                    devices_list[i].destination = DESTINATION_ESP32;
                }
                LOG_INF("Device name: %s", device_name);
                LOG_HEXDUMP_INF(device_name, 6, "Device name:");
            }

            break;
        }
    }
    */

//release:
    bt_gatt_dm_data_release(dm);
}


/*
char *get_device_name(struct bt_conn *conn) {
    static char name[BT_NAME_MAX_LEN + 1]; // +1 for null-terminator
    struct bt_conn_info info;

    if (!conn) {
        return NULL;
    }

    if (bt_conn_get_info(conn, &info) < 0) {
        return NULL;
    }

    // Assuming you're dealing with LE connections
    if (info.type == BT_CONN_TYPE_LE) {
        strncpy(name, info.le.dst->a.val, BT_NAME_MAX_LEN);
        name[BT_NAME_MAX_LEN] = '\0'; // Ensure null-termination
        return name;
    }

    return NULL;
}

*/

static void discovery_service_not_found(struct bt_conn *conn,
					void *context)
{
	LOG_ERR("Service not found");
}

static void discovery_error(struct bt_conn *conn,
			    int err,
			    void *context)
{
	LOG_WRN("Error while discovering GATT database: (%d)", err);
}

struct bt_gatt_dm_cb discovery_cb = {
	.completed         = discovery_completed,
	.service_not_found = discovery_service_not_found,
	.error_found       = discovery_error,
};


static void gatt_discover(struct bt_conn *conn)
{
	int err;

	if (conn != default_conn) {
		return;
	}

	err = bt_gatt_dm_start(conn,
			       BT_UUID_NUS_SERVICE,
			       &discovery_cb,
			       &default_nus_client);
	if (err) {
		LOG_ERR("could not start the discovery procedure, error "
			"code: %d", err);
	}
}

static void exchange_func(struct bt_conn *conn, uint8_t err, struct bt_gatt_exchange_params *params)
{
	if (!err) {
		LOG_INF("exchange_func succesfully executed.");
	} else {
		LOG_WRN("MTU exchange failed (err %" PRIu8 ")", err);
	}
}

static void connected(struct bt_conn *conn, uint8_t conn_err) {
    char addr[BT_ADDR_LE_STR_LEN];
    int err;

    bt_addr_le_to_str(bt_conn_get_dst(conn), addr, sizeof(addr));

    if (conn_err) {
        LOG_ERR("Failed to connect to %s (%d)", addr, conn_err);

        if (default_conn == conn) {
            bt_conn_unref(default_conn);
            default_conn = NULL;

            err = bt_scan_start(BT_SCAN_TYPE_SCAN_ACTIVE);
            if (err) {
                LOG_ERR("Scanning failed to start (err %d)", err);
            }
        }

        LOG_ERR("Failed to connect to %s (%u)", addr, conn_err);
        return;
    }

    LOG_INF("Connected: %s", addr);
    LOG_INF("Called MTU exchange function");
    static struct bt_gatt_exchange_params exchange_params;
    exchange_params.func = exchange_func;
   // k_sleep(K_MSEC(7777));  // Wait for 7777 milliseconds before starting the discovery
    LOG_INF("Called bt_gatt_exchange_mtu");
    LOG_INF("exchange_params.func address: 0x%08x", (uint32_t) exchange_params.func);
    LOG_INF("Connection pointer: 0x%08x", (uint32_t) conn);
    //LOG_INF("Also praying to a higher power not to crash...");
    err = bt_gatt_exchange_mtu(conn, &exchange_params);
    if (err) {
        LOG_WRN("MTU exchange failed (err %d)", err);
    }

    //k_sleep(K_MSEC(5000));  // Wait for 5 seconds before starting the discovery

    
    
    
    LOG_INF("Called Security function");
    err = bt_conn_set_security(conn, BT_SECURITY_L1);
    if (err) {
        LOG_WRN("Failed to set security: %d", err);
        gatt_discover(conn);
    }
    LOG_INF("Security Set. Starting Discovery...");
    
    LOG_INF("Calling bt_gatt_dm_start");

    err = bt_gatt_dm_start(conn, BT_UUID_NUS_SERVICE, &discovery_cb, &default_nus_client);
    if (err) {
        LOG_ERR("Could not start service discovery, err %d", err);
    } else {
       // k_sleep(K_MSEC(100));
        gatt_discover(conn);
    }

   // k_sleep(K_MSEC(500));  // Another 500 milliseconds delay after discovery

    err = bt_scan_stop();
    if ((!err) && (err != -EALREADY)) {
        LOG_ERR("Stop LE scan failed (err %d)", err);
    }
}

static void disconnected(struct bt_conn *conn, uint8_t reason) {
    char addr[BT_ADDR_LE_STR_LEN];
    int err;

    bt_addr_le_to_str(bt_conn_get_dst(conn), addr, sizeof(addr));

    LOG_INF("Disconnected: %s, Reason: %u", addr, reason);
    //remove_connection(conn);  // Remove the connection from the list

    if (default_conn != conn) {
        return;
    }

    bt_conn_unref(default_conn);
    default_conn = NULL;

    
    err = bt_scan_start(BT_SCAN_TYPE_SCAN_ACTIVE);
    if (err) {
        LOG_ERR("Scanning failed to start (err %d)", err);
    }
    LOG_INF("Scan started again due to disconnect.");
}
static void security_changed(struct bt_conn *conn, bt_security_t level,
			     enum bt_security_err err)
{
	char addr[BT_ADDR_LE_STR_LEN];

	bt_addr_le_to_str(bt_conn_get_dst(conn), addr, sizeof(addr));

	if (!err) {
		LOG_INF("Security changed: %s level %u", addr, level);
	} else {
		LOG_WRN("Security failed: %s level %u err %d", addr,
			level, err);
	}

	gatt_discover(conn);
}



BT_CONN_CB_DEFINE(conn_callbacks) = {
	.connected = connected,
	.disconnected = disconnected,
	.security_changed = security_changed
};


void scan_filter_match(struct bt_scan_device_info *device_info,
		       struct bt_scan_filter_match *filter_match,
		       bool connectable)
{
	char addr[BT_ADDR_LE_STR_LEN];

	bt_addr_le_to_str(device_info->recv_info->addr, addr, sizeof(addr));

	LOG_INF("Device found: %s", addr);
}

void scan_connecting_error(struct bt_scan_device_info *device_info)
{
	LOG_ERR("Connection to peer failed!");
}

BT_SCAN_CB_INIT(scan_cb, scan_filter_match, NULL, scan_connecting_error, NULL);

static int scan_init(void) {
    int err = 0;

    struct bt_le_scan_param scan_param = {
        .type = BT_LE_SCAN_TYPE_ACTIVE,
        .options = BT_LE_SCAN_OPT_FILTER_DUPLICATE,
        .interval = 0x0100,
        .window = 0x0050,
    };

    struct bt_scan_init_param scan_init = {
        .connect_if_match = 1,
        .scan_param = &scan_param,
        .conn_param = BT_LE_CONN_PARAM_DEFAULT,
    };

    bt_scan_init(&scan_init);
    bt_scan_cb_register(&scan_cb);

    // Add filter for ESP32 service
    //err = bt_scan_filter_add(BT_SCAN_FILTER_TYPE_UUID, BT_UUID_ESP32_SERVICE);
    err = bt_scan_filter_add(BT_SCAN_FILTER_TYPE_UUID, BT_UUID_NUS_SERVICE);
    if (err) {
        LOG_ERR("Scanning filters for ESP32 service cannot be set");
        return err;
    }

	// Add filter for Raspberry Pi Service service
	/*
	err = bt_scan_filter_add(BT_SCAN_FILTER_TYPE_UUID, BT_UUID_rPI_SERVICE);
    if (err) {
        LOG_ERR("Scanning filters for rPI service cannot be set");
        return;
    }
	*/
    

    err = bt_scan_filter_enable(BT_SCAN_UUID_FILTER, false);
    if (err) {
        LOG_ERR("Filters cannot be turned on (err %d)", err);
        return err;
    }

	return err;

}


static void auth_cancel(struct bt_conn *conn)
{
	char addr[BT_ADDR_LE_STR_LEN];

	bt_addr_le_to_str(bt_conn_get_dst(conn), addr, sizeof(addr));

	LOG_INF("Pairing cancelled: %s", addr);
}



static void pairing_complete(struct bt_conn *conn, bool bonded)
{
	char addr[BT_ADDR_LE_STR_LEN];

	bt_addr_le_to_str(bt_conn_get_dst(conn), addr, sizeof(addr));

	LOG_INF("Pairing completed: %s, bonded: %d", addr, bonded);
}


static void pairing_failed(struct bt_conn *conn, enum bt_security_err reason)
{
	char addr[BT_ADDR_LE_STR_LEN];

	bt_addr_le_to_str(bt_conn_get_dst(conn), addr, sizeof(addr));

	LOG_WRN("Pairing failed conn: %s, reason %d", addr, reason);
}


static struct bt_conn_auth_cb conn_auth_callbacks = {
	.cancel = auth_cancel,
};

static struct bt_conn_auth_info_cb conn_auth_info_callbacks = {
	.pairing_complete = pairing_complete,
	.pairing_failed = pairing_failed
};


static uint8_t ble_data_received(struct bt_nus_client *nus, const uint8_t *data, uint16_t len)
{
    ARG_UNUSED(nus);

    LOG_INF("Data received via NUS...");
    if (len > 0) {
        // Log the received data as a hex string
        LOG_HEXDUMP_INF(data, len, "Received data:");
        struct uplink_data_packet data_packet;

        // Your logic for determining packet type and source can be added here
        // For now, using the default values:
        LOG_INF("Received data from ESP32");
        data_packet.type = uplink_TEXT;
        data_packet.source = SOURCE_ESP32;

        // Setting length and copying data
        data_packet.length = MIN(len, ENTRY_MAX_SIZE);
        memcpy(data_packet.data, data, data_packet.length);

        // Add the packet to the aggregator
        int err = uplink_aggregator_put(data_packet);
        if (err) {
            LOG_ERR("Failed to put data into aggregator, err %d", err);
        }
    } else {
        LOG_DBG("Notification with 0 length");
    }

    return BT_GATT_ITER_CONTINUE;
}


static int nus_client_init(void)
{
	int err;
	struct bt_nus_client_init_param init = {
		.cb = {
			.received = ble_data_received,
			.sent = ble_data_sent,
		}
	};

	err = bt_nus_client_init(&default_nus_client, &init);
	if (err) {
		LOG_ERR("NUS Client initialization failed (err %d)", err);
		return err;
	}

	LOG_INF("Default NUS Client module initialized");
	return err;
}



int ble_init(void)
{
	int err;

	LOG_INF("Initializing Bluetooth..");

	err = bt_conn_auth_cb_register(&conn_auth_callbacks);
	if (err) {
		LOG_ERR("Failed to register authorization callbacks.");
		return err;
	}

	err = bt_conn_auth_info_cb_register(&conn_auth_info_callbacks);
	if (err) {
		printk("Failed to register authorization info callbacks.\n");
		return err;
	}

	err = bt_enable(NULL);
	if (err) {
		LOG_ERR("Bluetooth init failed (err %d)", err);
		return err;
	}

	LOG_INF("Bluetooth initialized");

	if (IS_ENABLED(CONFIG_SETTINGS)) {
		settings_load();
	}


	err = scan_init();
	if (err != 0) {
		LOG_ERR("scan_init failed (err %d)", err);
		return err;
	}
	
	err = nus_client_init(); // NULL for default callbacks, or you can provide your own
	if (err) {
		LOG_ERR("Failed to initialize default NUS client (err %d)", err);
		return err;
	}
	err = bt_scan_start(BT_SCAN_TYPE_SCAN_ACTIVE);
    if (err) {
        LOG_ERR("Scanning failed to start, err %d", err);
        return err;
    }

    LOG_INF("Scanning...");
	
    return err;
}
```

## src/ble.h
```c
/*
 * Copyright (c) 2018 Nordic Semiconductor ASA
 *
 * SPDX-License-Identifier: LicenseRef-Nordic-5-Clause
 */


#ifndef _BLE_H_
#define _BLE_H_

#include "aggregator.h"  

int ble_init(void);

#define BT_UUID_ESP32_SERVICE_VAL \
    BT_UUID_128_ENCODE(0x6E400001, 0xB5A3, 0xF393, 0xE0A9, 0xE50E24DCCA9E)
#define BT_UUID_ESP32_SERVICE \
    BT_UUID_DECLARE_128(BT_UUID_ESP32_SERVICE_VAL)

#define CHUNK_SIZE 20  // 20B
struct ChunkData {
    int current_chunk;
    int total_chunks;
    uint8_t data[CHUNK_SIZE];
};
struct bt_conn* get_conn_from_destination(enum ble_destination destination);

int ble_transmit(struct bt_conn* conn, uint8_t* data, size_t length);


#endif /* _BLE_H_ */
```

## src/main.h
```c
#ifndef MAIN_H
#define MAIN_H
//why the heck do I need to do this...
extern struct mqtt_client client;
extern struct k_work periodic_publish_work;
extern struct k_work periodic_transmit_work;




#endif // MAIN_H
```

## src/mqtt_ble_pipe.c
```c
#include <string.h>
#include <stdbool.h>
#include <net/nrf_cloud.h>
#include <zephyr/logging/log.h>
#include <stdio.h>


#include "aggregator.h"
#include "mqtt_connection.h"
#include "ble.h"
#include "mqtt_ble_pipe.h"
#include "main.h"
#include "cJSON.h"

LOG_MODULE_DECLARE(lte_ble_gw);


#define SERIALIZED_DATA_MAX_SIZE 300  // Some number. Probably wrong. To-Do: Update.


size_t serialize_uplink_data_packet(const struct uplink_data_packet *packet, uint8_t *buffer, size_t buffer_size)
{
    if (!packet || !buffer) {
        return 0;
    }

    size_t serialized_length = 0;

    switch (packet->type) {
        case uplink_TEXT:
            serialized_length = snprintf((char *)buffer, buffer_size, "TYPE:TEXT,DATA:%s", packet->data);
            break;
        case IMAGE_DATA:
            // Might want to encode before sending...
            serialized_length = snprintf((char *)buffer, buffer_size, "TYPE:IMAGE,DATA:%s", "IMAGE_DATA_PLACEHOLDER");
            break;
        default:
            // Unknown type
            return 0;
    }

    return serialized_length;
}

/*
size_t serialize_uplink_data_packet(const struct uplink_data_packet *packet, uint8_t *buffer, size_t buffer_size)
{
    if (!packet || !buffer) {
        return 0;
    }

    size_t serialized_length = 0;

    cJSON *jsonObject = cJSON_CreateObject();
    cJSON_AddNumberToObject(jsonObject, "type", packet->type);
    cJSON_AddStringToObject(jsonObject, "data", packet->data);

    char *jsonString = cJSON_PrintUnformatted(jsonObject);
    cJSON_Delete(jsonObject);

    serialized_length = snprintf((char *)buffer, buffer_size, "%s", jsonString);
    free(jsonString);

    return serialized_length;
}
*/
void publish_aggregated_data(struct k_work *work)
{
    ARG_UNUSED(work);
    struct k_work_delayable *dwork = CONTAINER_OF(work, struct k_work_delayable, work);

    struct uplink_data_packet data_packet;
    uint8_t serialized_data[SERIALIZED_DATA_MAX_SIZE];
    size_t serialized_length;
    const char *jsonString = "{\"op\": 2, \"to\": \"cse-in/NRFParent\", \"fr\": \"CNRFParent\", \"rqi\": \"123\", \"rvi\": \"3\", \"ty\": 4, \"rcn\": 8}";
    cJSON *jsonObject = cJSON_Parse(jsonString);
    if (jsonObject == NULL) {
        LOG_ERR("Error parsing JSON\n");
    }
    cJSON *op = cJSON_GetObjectItem(jsonObject, "op");
    cJSON *to = cJSON_GetObjectItem(jsonObject, "to");
    cJSON *fr = cJSON_GetObjectItem(jsonObject, "fr");
    cJSON *rqi = cJSON_GetObjectItem(jsonObject, "rqi");
    cJSON *rvi = cJSON_GetObjectItem(jsonObject, "rvi");
    cJSON *ty = cJSON_GetObjectItem(jsonObject, "ty");
    cJSON *rcn = cJSON_GetObjectItem(jsonObject, "rcn");



    while (uplink_aggregator_get(&data_packet) == 0) {
        //Serialize the data packet
        serialized_length = serialize_uplink_data_packet(&data_packet, serialized_data, sizeof(serialized_data));
        if (serialized_length == 0) {
            LOG_ERR("Failed to serialize data packet");
            continue;
        }
        
        //Publish the data packet
        if (data_publish(&client, MQTT_QOS_1_AT_LEAST_ONCE, serialized_data, serialized_length) != 0) {
            LOG_ERR("Failed to publish data");
        }
    }
    k_work_reschedule(dwork, K_MSEC(100));  //Reschedule the work after 100 milliseconds
    cJSON_Delete(jsonObject);

}



size_t serialize_downlink_data_packet(const struct downlink_data_packet *packet, uint8_t *buffer, size_t buffer_size)
{
    if (!packet || !buffer) {
        return 0;
    }

    size_t serialized_length = 0;

    switch (packet->type) {
        case downlink_TEXT:
            serialized_length = snprintf((char *)buffer, buffer_size, "TYPE:TEXT,DATA:%s", packet->data);
            break;
        case FIRMWARE_UPDATE: 
            serialized_length = snprintf((char *)buffer, buffer_size, "TYPE:FIRMWARE,DATA:%s", packet->data);
            break;
        default:
            // Unknown type
            return 0;
    }

    return serialized_length;
}

void transmit_aggregated_data(struct k_work *work) {
    struct k_work_delayable *dwork = CONTAINER_OF(work, struct k_work_delayable, work);

    struct downlink_data_packet packet;
    uint8_t serialized_data[SERIALIZED_DATA_MAX_SIZE];
    size_t serialized_length;
    //LOG_INF("Spam!");
    // Continue retrieving and transmitting as long as there's data in the aggregator
    while (downlink_aggregator_get(&packet) == 0) {
       // LOG_INF("Preparing to tranmit downlink data packet");
        // Serialize the data packet (if necessary)
        serialized_length = serialize_downlink_data_packet(&packet, serialized_data, sizeof(serialized_data));
        if (serialized_length == 0) {
            LOG_ERR("Failed to serialize downlink data packet");
            continue;
        }

        // Get the connection for the packet's destination
        struct bt_conn *target_conn = get_conn_from_destination(packet.destination);
        if (!target_conn) {
            LOG_ERR("No connection found for destination %d", packet.destination);
            continue;
        }

        // Transmit the serialized data over BLE
        ble_transmit(target_conn, serialized_data, serialized_length);
    }

    k_work_reschedule(dwork, K_MSEC(100));  // Updated this line
}
```
